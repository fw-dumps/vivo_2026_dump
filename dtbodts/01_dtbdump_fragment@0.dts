/dts-v1/;

/ {

	__fixups__ {
		audgpio = "/fragment@22:target:0";
		auxadc = "/fragment@32:target:0", "/fragment@53/__overlay__:io-channels:0", "/fragment@54/__overlay__:io-channels:0", "/fragment@54/__overlay__:io-channels:8";
		battery = "/fragment@54:target:0";
		battery_id = "/fragment@53:target:0";
		board_info = "/fragment@78:target:0";
		boards_version = "/fragment@77:target:0";
		camera_af_hw_node = "/fragment@74:target:0";
		charge = "/fragment@55:target:0";
		chosen = "/fragment@0:target:0";
		cms_v2 = "/fragment@57:target:0";
		consys = "/fragment@7:target:0", "/fragment@76:target:0";
		dsi_te = "/fragment@63:target:0";
		flashlights_lm3644 = "/fragment@30:target:0";
		fp_id = "/fragment@19:target:0";
		fpsensor_fp_eint = "/fragment@62:target:0";
		fuelsummary = "/fragment@59:target:0";
		goodix_fp = "/fragment@13:target:0", "/fragment@61:target:0";
		gpio = "/fragment@45:target:0";
		gpio_usage_mapping = "/fragment@44:target:0";
		i2c0 = "/fragment@34:target:0", "/fragment@82:target:0";
		i2c1 = "/fragment@35:target:0";
		i2c2 = "/fragment@36:target:0";
		i2c3 = "/fragment@2:target:0", "/fragment@37:target:0";
		i2c4 = "/fragment@38:target:0";
		i2c5 = "/fragment@39:target:0", "/fragment@60:target:0";
		i2c6 = "/fragment@3:target:0", "/fragment@15:target:0", "/fragment@40:target:0";
		i2c7 = "/fragment@41:target:0";
		i2c8 = "/fragment@42:target:0";
		i2c9 = "/fragment@43:target:0";
		irq_nfc = "/fragment@50:target:0";
		irtx_pwm = "/fragment@20:target:0";
		kd_camera_hw1 = "/fragment@28:target:0", "/fragment@73:target:0";
		keypad = "/fragment@8:target:0", "/fragment@75:target:0";
		main_pmic = "/fragment@64:target:0";
		md1_sim1_hot_plug_eint = "/fragment@65:target:0";
		meter = "/fragment@56:target:0";
		mrdump_ext_rst = "/fragment@48:target:0";
		msdc1 = "/fragment@31:target:0";
		msdc1_ins = "/fragment@47:target:0";
		mt6370_chg = "/fragment@26:target:0";
		mt6370_pmu = "/fragment@24:target:0";
		mt6370_typec = "/fragment@25:target:0";
		mt_pmic_vcama_ldo_reg = "/fragment@12/__overlay__/fingerprint@0:vfp-supply:0", "/fragment@61/__overlay__:vfp-supply:0", "/fragment@66:target:0";
		mt_pmic_vcamd_ldo_reg = "/fragment@69:target:0", "/fragment@73/__overlay__:cam0_vcamd-supply:0", "/fragment@73/__overlay__:cam1_vcamd-supply:0", "/fragment@73/__overlay__:cam3_vcamd-supply:0";
		mt_pmic_vcamio_ldo_reg = "/fragment@70:target:0", "/fragment@73/__overlay__:cam0_vcamio-supply:0", "/fragment@73/__overlay__:cam1_vcamio-supply:0", "/fragment@73/__overlay__:cam2_vcamio-supply:0", "/fragment@73/__overlay__:cam3_vcamio-supply:0";
		mt_pmic_vio28_ldo_reg = "/fragment@72:target:0", "/fragment@74/__overlay__:camaf_m1_pmic-supply:0";
		mt_pmic_vldo28_ldo_reg = "/fragment@71:target:0";
		mt_pmic_vsim1_ldo_reg = "/fragment@67:target:0";
		mt_pmic_vsim2_ldo_reg = "/fragment@68:target:0";
		mtkfb = "/fragment@16:target:0";
		odm = "/fragment@1:target:0", "/fragment@81:target:0";
		otg_iddig = "/fragment@52:target:0";
		pio = "/fragment@4:target:0", "/fragment@5:target:0", "/fragment@6:target:0", "/fragment@9:target:0", "/fragment@11:target:0", "/fragment@14:target:0", "/fragment@17:target:0", "/fragment@18:target:0", "/fragment@19/__overlay__:fp_id,gpios:0", "/fragment@21:target:0", "/fragment@23:target:0", "/fragment@24/__overlay__:mt6370,intr_gpio:0", "/fragment@25/__overlay__:mt6370pd,intr_gpio:0", "/fragment@27:target:0", "/fragment@29:target:0", "/fragment@44/__overlay__:GPIO_SIM2_SIO:0", "/fragment@44/__overlay__:GPIO_SIM2_SRST:0", "/fragment@44/__overlay__:GPIO_SIM2_SCLK:0", "/fragment@44/__overlay__:GPIO_SIM1_SCLK:0", "/fragment@44/__overlay__:GPIO_SIM1_SRST:0", "/fragment@44/__overlay__:GPIO_SIM1_SIO:0", "/fragment@44/__overlay__:GPIO_SIM1_HOT_PLUG:0", "/fragment@44/__overlay__:GPIO_FDD_BAND_SUPPORT_DETECT_1ST_PIN:0", "/fragment@44/__overlay__:GPIO_FDD_BAND_SUPPORT_DETECT_2ND_PIN:0", "/fragment@44/__overlay__:GPIO_FDD_BAND_SUPPORT_DETECT_3RD_PIN:0", "/fragment@44/__overlay__:GPIO_FDD_BAND_SUPPORT_DETECT_4TH_PIN:0", "/fragment@44/__overlay__:GPIO_FDD_BAND_SUPPORT_DETECT_5TH_PIN:0", "/fragment@46/__overlay__:interrupt-parent:0", "/fragment@47/__overlay__:interrupt-parent:0", "/fragment@48/__overlay__:interrupt-parent:0", "/fragment@48/__overlay__:deb-gpios:0", "/fragment@49/__overlay__:interrupt-parent:0", "/fragment@49/__overlay__:deb-gpios:0", "/fragment@49/__overlay__:deb-rgpios:0", "/fragment@50/__overlay__:interrupt-parent:0", "/fragment@51/__overlay__:interrupt-parent:0", "/fragment@52/__overlay__:interrupt-parent:0", "/fragment@52/__overlay__:usbid-num:0", "/fragment@52/__overlay__:usbid2-num:0", "/fragment@52/__overlay__:platform-id:0", "/fragment@53/__overlay__:vivo,bat-adc-ctrl-gpio:0", "/fragment@55/__overlay__:vivo,usboe-gpio:0", "/fragment@57/__overlay__/single_charger_board:vivo,bat-id-gpio:0", "/fragment@60/__overlay__/bq25890h@6a:vivo,int-gpio:0", "/fragment@60/__overlay__/bq25601d@6b:vivo,int-gpio:0", "/fragment@60/__overlay__/rt9467@5b:vivo,int-gpio:0", "/fragment@61/__overlay__:interrupt-parent:0", "/fragment@62/__overlay__:int-gpios:0", "/fragment@63/__overlay__:interrupt-parent:0", "/fragment@64/__overlay__:interrupt-parent:0", "/fragment@76/__overlay__:compatible-gpios:0", "/fragment@77/__overlay__:gpios_start:0", "/fragment@77/__overlay__:pcb_gpios_start:0", "/fragment@79/__overlay__:card-detect-sim1,gpios:0", "/fragment@79/__overlay__:card-detect-sim2,gpios:0", "/fragment@79/__overlay__:card-detect-tf-card,gpios:0", "/fragment@80:target:0", "/fragment@82/__overlay__/aw87xxx_i2c@58:reset-gpio:0", "/fragment@84:target:0", "/fragment@85/__overlay__/vts_device@0/nt36672:novatek,irq-gpio:0", "/fragment@85/__overlay__/vts_device@0/ili9881h:ilitek,reset-gpio:0", "/fragment@85/__overlay__/vts_device@0/ili9881h:ilitek,irq-gpio:0", "/fragment@85/__overlay__/vts_device@0/ili_9882n:touch,reset-gpio:0", "/fragment@85/__overlay__/vts_device@0/ili_9882n:touch,irq-gpio:0", "/fragment@85/__overlay__/vts_device@0/nt36525:novatek,reset-gpio:0", "/fragment@85/__overlay__/vts_device@0/nt36525:novatek,irq-gpio:0", "/fragment@85/__overlay__/vts_device@0/ft8016:focaltech,reset-gpio:0", "/fragment@85/__overlay__/vts_device@0/ft8016:focaltech,irq-gpio:0", "/fragment@85/__overlay__/vts_device@0/chipone:chipone,rst-gpio:0", "/fragment@85/__overlay__/vts_device@0/chipone:chipone,irq-gpio:0";
		pmic_accdet = "/fragment@10:target:0", "/fragment@49:target:0";
		pmic_clock_buffer_ctrl = "/fragment@33:target:0";
		power_supply_lite = "/fragment@58:target:0";
		spi0 = "/fragment@12:target:0";
		spi2 = "/fragment@85:target:0";
		subpmic_pmu_eint = "/fragment@51:target:0";
		tcard_sim_slot = "/fragment@79:target:0";
		touch = "/fragment@46:target:0";
		touchscreencfg = "/fragment@83:target:0";
	};

	__local_fixups__ {

		fragment@10 {

			__overlay__ {
				pinctrl-0 = <0x0>;
				pinctrl-1 = <0x0>;
				pinctrl-2 = <0x0>;
			};
		};

		fragment@13 {

			__overlay__ {
				pinctrl-0 = <0x0>;
				pinctrl-1 = <0x0>;
				pinctrl-10 = <0x0>;
				pinctrl-11 = <0x0>;
				pinctrl-12 = <0x0>;
				pinctrl-13 = <0x0>;
				pinctrl-14 = <0x0>;
				pinctrl-2 = <0x0>;
				pinctrl-3 = <0x0>;
				pinctrl-4 = <0x0>;
				pinctrl-5 = <0x0>;
				pinctrl-6 = <0x0>;
				pinctrl-7 = <0x0>;
				pinctrl-8 = <0x0>;
				pinctrl-9 = <0x0>;
			};
		};

		fragment@16 {

			__overlay__ {
				pinctrl-0 = <0x0>;
				pinctrl-1 = <0x0>;
				pinctrl-10 = <0x0>;
				pinctrl-11 = <0x0>;
				pinctrl-2 = <0x0>;
				pinctrl-3 = <0x0>;
				pinctrl-4 = <0x0>;
				pinctrl-5 = <0x0>;
				pinctrl-6 = <0x0>;
				pinctrl-7 = <0x0>;
				pinctrl-8 = <0x0>;
				pinctrl-9 = <0x0>;
			};
		};

		fragment@19 {

			__overlay__ {
				pinctrl-0 = <0x0>;
				pinctrl-1 = <0x0>;
			};
		};

		fragment@20 {

			__overlay__ {
				pinctrl-0 = <0x0>;
				pinctrl-1 = <0x0>;
			};
		};

		fragment@22 {

			__overlay__ {
				pinctrl-0 = <0x0>;
				pinctrl-1 = <0x0>;
				pinctrl-2 = <0x0>;
				pinctrl-3 = <0x0>;
			};
		};

		fragment@28 {

			__overlay__ {
				pinctrl-0 = <0x0>;
				pinctrl-1 = <0x0>;
				pinctrl-10 = <0x0>;
				pinctrl-11 = <0x0>;
				pinctrl-12 = <0x0>;
				pinctrl-13 = <0x0>;
				pinctrl-14 = <0x0>;
				pinctrl-15 = <0x0>;
				pinctrl-16 = <0x0>;
				pinctrl-17 = <0x0>;
				pinctrl-18 = <0x0>;
				pinctrl-19 = <0x0>;
				pinctrl-2 = <0x0>;
				pinctrl-20 = <0x0>;
				pinctrl-21 = <0x0>;
				pinctrl-22 = <0x0>;
				pinctrl-23 = <0x0>;
				pinctrl-24 = <0x0>;
				pinctrl-3 = <0x0>;
				pinctrl-4 = <0x0>;
				pinctrl-5 = <0x0>;
				pinctrl-6 = <0x0>;
				pinctrl-7 = <0x0>;
				pinctrl-8 = <0x0>;
				pinctrl-9 = <0x0>;
			};
		};

		fragment@30 {

			__overlay__ {
				pinctrl-0 = <0x0>;
				pinctrl-1 = <0x0>;
				pinctrl-2 = <0x0>;
				pinctrl-3 = <0x0>;
			};
		};

		fragment@52 {

			__overlay__ {
				pinctrl-0 = <0x0>;
				pinctrl-1 = <0x0>;
				pinctrl-10 = <0x0>;
				pinctrl-11 = <0x0>;
				pinctrl-12 = <0x0>;
				pinctrl-2 = <0x0>;
				pinctrl-3 = <0x0>;
				pinctrl-4 = <0x0>;
				pinctrl-5 = <0x0>;
				pinctrl-6 = <0x0>;
				pinctrl-7 = <0x0>;
				pinctrl-8 = <0x0>;
				pinctrl-9 = <0x0>;
			};
		};

		fragment@7 {

			__overlay__ {
				pinctrl-0 = <0x0>;
				pinctrl-1 = <0x0>;
				pinctrl-2 = <0x0>;
				pinctrl-3 = <0x0>;
			};
		};

		fragment@77 {

			__overlay__ {
				pinctrl-0 = <0x0>;
			};
		};

		fragment@79 {

			__overlay__ {
				pinctrl-0 = <0x0>;
			};
		};

		fragment@8 {

			__overlay__ {
				pinctrl-0 = <0x0>;
			};
		};

		fragment@85 {

			__overlay__ {

				vts_device@0 {

					nt36525 {
						pinctrl-0 = <0x0>;
					};

					nt36672 {
						pinctrl-0 = <0x0>;
					};
				};
			};
		};
	};

	__symbols__ {
		ACCDET_pins_eint_r_int = "/fragment@11/__overlay__/eint_hphr@0";
		accdet_pins_default = "/fragment@11/__overlay__/accdetdefault";
		accdet_pins_eint_as_int = "/fragment@11/__overlay__/accdeteint@0";
		aud_dat_miso_off = "/fragment@23/__overlay__/aud_dat_miso_off";
		aud_dat_miso_on = "/fragment@23/__overlay__/aud_dat_miso_on";
		aud_dat_mosi_off = "/fragment@23/__overlay__/aud_dat_mosi_off";
		aud_dat_mosi_on = "/fragment@23/__overlay__/aud_dat_mosi_on";
		board_version = "/fragment@80/__overlay__/hardware_board_version";
		camera_main_af_mtk = "/fragment@36/__overlay__/camera_main_af@18";
		camera_main_eeprom_mtk = "/fragment@36/__overlay__/camera_main_eeprom@50";
		camera_main_mtk = "/fragment@36/__overlay__/camera_main@1a";
		camera_main_three_eeprom_mtk = "/fragment@38/__overlay__/camera_main_three_eeprom@50";
		camera_main_three_mtk = "/fragment@38/__overlay__/camera_main_three@2d";
		camera_main_two_af_mtk = "/fragment@38/__overlay__/camera_main_two_af@18";
		camera_main_two_eeprom_mtk = "/fragment@38/__overlay__/camera_main_two_eeprom@50";
		camera_main_two_mtk = "/fragment@38/__overlay__/camera_main_two@2d";
		camera_pins_cam0_mclk_off = "/fragment@27/__overlay__/camera_pins_cam0_mclk_off";
		camera_pins_cam0_mclk_on = "/fragment@27/__overlay__/camera_pins_cam0_mclk_on";
		camera_pins_cam0_rst0 = "/fragment@27/__overlay__/cam0@0";
		camera_pins_cam0_rst1 = "/fragment@27/__overlay__/cam0@1";
		camera_pins_cam0_vcama_0 = "/fragment@27/__overlay__/cam0@vcama0";
		camera_pins_cam0_vcama_1 = "/fragment@27/__overlay__/cam0@vcama1";
		camera_pins_cam1_mclk_off = "/fragment@27/__overlay__/camera_pins_cam1_mclk_off";
		camera_pins_cam1_mclk_on = "/fragment@27/__overlay__/camera_pins_cam1_mclk_on";
		camera_pins_cam1_rst0 = "/fragment@27/__overlay__/cam1@0";
		camera_pins_cam1_rst1 = "/fragment@27/__overlay__/cam1@1";
		camera_pins_cam1_vcama_0 = "/fragment@27/__overlay__/cam1@vcama0";
		camera_pins_cam1_vcama_1 = "/fragment@27/__overlay__/cam1@vcama1";
		camera_pins_cam2_mclk_off = "/fragment@27/__overlay__/camera_pins_cam2_mclk_off";
		camera_pins_cam2_mclk_on = "/fragment@27/__overlay__/camera_pins_cam2_mclk_on";
		camera_pins_cam2_rst0 = "/fragment@27/__overlay__/cam2@0";
		camera_pins_cam2_rst1 = "/fragment@27/__overlay__/cam2@1";
		camera_pins_cam2_vcama_0 = "/fragment@27/__overlay__/cam2@vcama0";
		camera_pins_cam2_vcama_1 = "/fragment@27/__overlay__/cam2@vcama1";
		camera_pins_cam3_mclk_off = "/fragment@27/__overlay__/camera_pins_cam3_mclk_off";
		camera_pins_cam3_mclk_on = "/fragment@27/__overlay__/camera_pins_cam3_mclk_on";
		camera_pins_cam3_rst0 = "/fragment@27/__overlay__/cam3@0";
		camera_pins_cam3_rst1 = "/fragment@27/__overlay__/cam3@1";
		camera_pins_cam3_vcama_0 = "/fragment@27/__overlay__/cam3@vcama0";
		camera_pins_cam3_vcama_1 = "/fragment@27/__overlay__/cam3@vcama1";
		camera_pins_default = "/fragment@27/__overlay__/camdefault";
		camera_sub_eeprom_mtk = "/fragment@36/__overlay__/camera_sub_eeprom@52";
		camera_sub_mtk = "/fragment@36/__overlay__/camera_sub@2d";
		camera_sub_two_eeprom_mtk = "/fragment@38/__overlay__/camera_sub_two_eeprom@50";
		camera_sub_two_mtk = "/fragment@38/__overlay__/camera_sub_two@2d";
		cap_touch_mtk = "/fragment@34/__overlay__/cap_touch@5d";
		card_detect = "/fragment@80/__overlay__/card_sim_detect";
		ccu_sensor_i2c_2_hw_mtk = "/fragment@36/__overlay__/ccu_sensor_i2c_2_hw@33";
		ccu_sensor_i2c_4_hw_mtk = "/fragment@38/__overlay__/ccu_sensor_i2c_4_hw@36";
		consys_pins_default = "/fragment@6/__overlay__/consys_default";
		default_board = "/fragment@57/__overlay__/single_charger_board";
		ext_buck_lp4_mtk = "/fragment@37/__overlay__/ext_buck_lp4@57";
		ext_buck_lp4x_mtk = "/fragment@37/__overlay__/ext_buck_lp4x@50";
		ext_buck_vgpu_mtk = "/fragment@40/__overlay__/ext_buck_vgpu@55";
		fingerprint_clk_pullhigh = "/fragment@14/__overlay__/state_clk_pullhigh";
		fingerprint_clk_pulllow = "/fragment@14/__overlay__/state_clk_pulllow";
		fingerprint_clk_spi = "/fragment@14/__overlay__/state_clk_spi";
		fingerprint_cs_pullhigh = "/fragment@14/__overlay__/state_cs_pullhigh";
		fingerprint_cs_pulllow = "/fragment@14/__overlay__/state_cs_pulllow";
		fingerprint_cs_spi = "/fragment@14/__overlay__/state_cs_spi";
		fingerprint_irq = "/fragment@14/__overlay__/state_irq";
		fingerprint_miso_pullhigh = "/fragment@14/__overlay__/state_miso_pullhigh";
		fingerprint_miso_pulllow = "/fragment@14/__overlay__/state_miso_pulllow";
		fingerprint_miso_spi = "/fragment@14/__overlay__/state_miso_spi";
		fingerprint_mosi_pullhigh = "/fragment@14/__overlay__/state_mosi_pullhigh";
		fingerprint_mosi_pulllow = "/fragment@14/__overlay__/state_mosi_pulllow";
		fingerprint_mosi_spi = "/fragment@14/__overlay__/state_mosi_spi";
		fingerprint_reset_high = "/fragment@14/__overlay__/state_reset_high";
		fingerprint_reset_low = "/fragment@14/__overlay__/state_reset_low";
		flashlights_lm3644_pins_default = "/fragment@29/__overlay__/flashlight_default";
		flashlights_lm3644_pins_hwen_high = "/fragment@29/__overlay__/hwen_high";
		flashlights_lm3644_pins_hwen_low = "/fragment@29/__overlay__/hwen_low";
		flashlights_lm3644_pins_irq = "/fragment@29/__overlay__/flash_irq";
		fp_id_gpio_down = "/fragment@18/__overlay__/fp_id_gpio_down";
		fp_id_gpio_up = "/fragment@18/__overlay__/fp_id_gpio_up";
		gpio110_mode0_gpio = "/fragment@4/__overlay__/iddig_gpio";
		gpio110_mode0_gpio_pull_down = "/fragment@4/__overlay__/iddig_gpio_pull_down";
		gpio110_mode1_iddig = "/fragment@4/__overlay__/iddig_init";
		gpio164_otg_pull1_high = "/fragment@4/__overlay__/otg_pull1_high";
		gpio164_otg_pull1_in = "/fragment@4/__overlay__/otg_pull1_in";
		gpio164_otg_pull1_low = "/fragment@4/__overlay__/otg_pull1_low";
		gpio165_otg_pull_high = "/fragment@4/__overlay__/otg_pull_high";
		gpio165_otg_pull_in = "/fragment@4/__overlay__/otg_pull_in";
		gpio165_otg_pull_low = "/fragment@4/__overlay__/otg_pull_low";
		gpio167_otg_pull1_high = "/fragment@4/__overlay__/otg167_pull1_high";
		gpio167_otg_pull1_in = "/fragment@4/__overlay__/otg167_pull1_in";
		gpio167_otg_pull1_low = "/fragment@4/__overlay__/otg167_pull1_low";
		gpslna_pins_init = "/fragment@6/__overlay__/gpslna@0";
		gpslna_pins_oh = "/fragment@6/__overlay__/gpslna@1";
		gpslna_pins_ol = "/fragment@6/__overlay__/gpslna@2";
		iddig_default = "/fragment@4/__overlay__/iddig_default";
		irtx_gpio_led_default = "/fragment@21/__overlay__/irtx_gpio_led_def@gpio90";
		irtx_gpio_led_set = "/fragment@21/__overlay__/irtx_gpio_led_set@gpio90";
		kpd_pins_default = "/fragment@9/__overlay__/kpdgpiodefault";
		lcm_bkg_en0_gpio = "/fragment@17/__overlay__/lcm_bkg_en0_gpio";
		lcm_bkg_en1_gpio = "/fragment@17/__overlay__/lcm_bkg_en1_gpio";
		lcm_enn_en0_gpio = "/fragment@17/__overlay__/lcm_enn_en0_gpio";
		lcm_enn_en1_gpio = "/fragment@17/__overlay__/lcm_enn_en1_gpio";
		lcm_enp_en0_gpio = "/fragment@17/__overlay__/lcm_enp_en0_gpio";
		lcm_enp_en1_gpio = "/fragment@17/__overlay__/lcm_enp_en1_gpio";
		lcm_rst_out0_gpio = "/fragment@17/__overlay__/lcm_rst_out0_gpio";
		lcm_rst_out1_gpio = "/fragment@17/__overlay__/lcm_rst_out1_gpio";
		lcm_vddi_en0_gpio = "/fragment@17/__overlay__/lcm_vddi_en0_gpio";
		lcm_vddi_en1_gpio = "/fragment@17/__overlay__/lcm_vddi_en1_gpio";
		led0 = "/fragment@1/__overlay__/led@0";
		led1 = "/fragment@1/__overlay__/led@1";
		led2 = "/fragment@1/__overlay__/led@2";
		led3 = "/fragment@1/__overlay__/led@3";
		led4 = "/fragment@1/__overlay__/led@4";
		led5 = "/fragment@1/__overlay__/led@5";
		led6 = "/fragment@1/__overlay__/led@6";
		spi2_clk_set_cfg = "/fragment@84/__overlay__/spi2_clk_set";
		spi2_cs_set_cfg = "/fragment@84/__overlay__/spi2_cs_set";
		spi2_miso_set_cfg = "/fragment@84/__overlay__/spi2_miso_set";
		spi2_mosi_set_cfg = "/fragment@84/__overlay__/spi2_mosi_set";
		spi_driving_set_cfg = "/fragment@5/__overlay__/spi_driving_set";
		spi_pins_pd2036_cfg = "/fragment@84/__overlay__/spi_pins_pd2036";
		subpmic_pmu_mtk = "/fragment@39/__overlay__/subpmic_pmu@34";
		tp_rst_out0_gpio = "/fragment@17/__overlay__/tp_rst_out0_gpio";
		tp_rst_out1_gpio = "/fragment@17/__overlay__/tp_rst_out1_gpio";
		vibrator0 = "/fragment@1/__overlay__/vibrator@0";
	};

	fragment@0 {
		target = <0xffffffff>;

		__overlay__ {
			atag,videolfb-fb_base_h = <0x0>;
			atag,videolfb-fb_base_l = "^`P";
			atag,videolfb-fps = <0x1770>;
			atag,videolfb-islcm_inited = <0x0>;
			atag,videolfb-islcmfound = <0x1>;
			atag,videolfb-lcmname = "nt35695B_fhd_dsi_cmd_auo_rt5081_drv";
			atag,videolfb-project-name = "PD2036F_EX";
			atag,videolfb-vramSize = <0x17bb000>;

			vivo,panel_info {
				vivo,panel-materiel-id-list = "1211713", "0x31", "1211715", "0xB1", "1211717", "0xA1", "1211736", "0xB3", "1211747", "0x91", "1211742", "0x92", "1211714", "0x11";
			};
		};
	};

	fragment@1 {
		target = <0xffffffff>;

		__overlay__ {

			led@0 {
				compatible = "mediatek,red";
				data = <0x1>;
				led_mode = <0x0>;
				phandle = <0x59>;
				pwm_config = <0x0 0x0 0x0 0x0 0x0>;
			};

			led@1 {
				compatible = "mediatek,green";
				data = <0x1>;
				led_mode = <0x0>;
				phandle = <0x5a>;
				pwm_config = <0x0 0x0 0x0 0x0 0x0>;
			};

			led@2 {
				compatible = "mediatek,blue";
				data = <0x1>;
				led_mode = <0x0>;
				phandle = <0x5b>;
				pwm_config = <0x0 0x0 0x0 0x0 0x0>;
			};

			led@3 {
				compatible = "mediatek,jogball-backlight";
				data = <0x1>;
				led_mode = <0x0>;
				phandle = <0x5c>;
				pwm_config = <0x0 0x0 0x0 0x0 0x0>;
			};

			led@4 {
				compatible = "mediatek,keyboard-backlight";
				data = <0x1>;
				led_mode = <0x0>;
				phandle = <0x5d>;
				pwm_config = <0x0 0x0 0x0 0x0 0x0>;
			};

			led@5 {
				compatible = "mediatek,button-backlight";
				data = <0x1>;
				led_mode = <0x0>;
				phandle = <0x5e>;
				pwm_config = <0x0 0x0 0x0 0x0 0x0>;
			};

			led@6 {
				compatible = "mediatek,lcd-backlight";
				data = <0x1>;
				led_mode = <0x4>;
				phandle = <0x5f>;
				pwm_config = <0x0 0x0 0x0 0x0 0x0>;
			};

			vibrator@0 {
				compatible = "mediatek,vibrator";
				phandle = <0x60>;
				vib_limit = <0x9>;
				vib_timer = <0x19>;
				vib_vol = <0x9>;
			};
		};
	};

	fragment@10 {
		target = <0xffffffff>;

		__overlay__ {
			accdet-mic-mode = <0x1>;
			accdet-mic-vol = <0x6>;
			accdet-plugout-debounce = <0x10>;
			headset-eint-level-pol = <0x8>;
			headset-four-key-threshold = <0x0 0x3c 0x6a 0xd2 0x1ae>;
			headset-mode-setting = <0x500 0x500 0x1 0x1f0 0x800 0x800 0x2000 0x44>;
			headset-three-key-threshold = <0x0 0x5a 0xd2 0x1ae>;
			headset-three-key-threshold-CDD = <0x0 0x79 0xc0 0x258>;
			pinctrl-0 = <0x6>;
			pinctrl-1 = <0x7>;
			pinctrl-2 = <0x8>;
			pinctrl-names = "default", "state_eint_as_int", "state_eint_r_as_int";
			status = "okay";
		};
	};

	fragment@11 {
		target = <0xffffffff>;

		__overlay__ {

			accdetdefault {
				phandle = <0x6>;
			};

			accdeteint@0 {
				phandle = <0x7>;

				pins_cmd_dat {
					bias-disable;
					pinmux = <0x400>;
					slew-rate = <0x0>;
				};
			};

			eint_hphr@0 {
				phandle = <0x8>;

				pins_cmd_dat {
					bias-disable;
					pinmux = <0x300>;
					slew-rate = <0x0>;
				};
			};
		};
	};

	fragment@12 {
		target = <0xffffffff>;

		__overlay__ {
			#address-cells = <0x1>;
			#size-cells = <0x0>;

			fingerprint@0 {
				compatible = "mediatek,fingerprint";
				netlink-event = <0x1e>;
				reg = <0x0>;
				spi-max-frequency = <0x7a1200>;
				status = "okay";
				vfp-supply = <0xffffffff>;
			};
		};
	};

	fragment@13 {
		target = <0xffffffff>;

		__overlay__ {
			pinctrl-0 = <0x9>;
			pinctrl-1 = <0xa>;
			pinctrl-10 = <0x13>;
			pinctrl-11 = <0x14>;
			pinctrl-12 = <0x15>;
			pinctrl-13 = <0x16>;
			pinctrl-14 = <0x17>;
			pinctrl-2 = <0xb>;
			pinctrl-3 = <0xc>;
			pinctrl-4 = <0xd>;
			pinctrl-5 = <0xe>;
			pinctrl-6 = <0xf>;
			pinctrl-7 = <0x10>;
			pinctrl-8 = <0x11>;
			pinctrl-9 = <0x12>;
			pinctrl-names = "fingerprint_irq", "miso_spi", "miso_pullhigh", "miso_pulllow", "reset_high", "reset_low", "mosi_spi", "mosi_pullhigh", "mosi_pulllow", "cs_spi", "cs_pullhigh", "cs_pulllow", "clk_spi", "clk_pullhigh", "clk_pulllow";
			status = "okay";
		};
	};

	fragment@14 {
		target = <0xffffffff>;

		__overlay__ {

			state_clk_pullhigh {
				phandle = <0x16>;

				pins_cmd_dat {
					output-high;
					pinmux = <0x9e00>;
					slew-rate = <0x1>;
				};
			};

			state_clk_pulllow {
				phandle = <0x17>;

				pins_cmd_dat {
					output-low;
					pinmux = <0x9e00>;
					slew-rate = <0x1>;
				};
			};

			state_clk_spi {
				phandle = <0x15>;

				pins_cmd_dat {
					drive-strength = <0x3>;
					pinmux = <0x9e01>;
				};
			};

			state_cs_pullhigh {
				phandle = <0x13>;

				pins_cmd_dat {
					output-high;
					pinmux = <0x9c00>;
					slew-rate = <0x3>;
				};
			};

			state_cs_pulllow {
				phandle = <0x14>;

				pins_cmd_dat {
					output-low;
					pinmux = <0x9c00>;
					slew-rate = <0x1>;
				};
			};

			state_cs_spi {
				phandle = <0x12>;

				pins_cmd_dat {
					drive-strength = <0x1>;
					pinmux = <0x9c01>;
				};
			};

			state_irq {
				phandle = <0x9>;

				pins_cmd_dat {
					bias-disable;
					pinmux = <0x500>;
					slew-rate = <0x0>;
				};
			};

			state_miso_pullhigh {
				phandle = <0xb>;

				pins_cmd_dat {
					output-high;
					pinmux = <0x9b00>;
					slew-rate = <0x1>;
				};
			};

			state_miso_pulllow {
				phandle = <0xc>;

				pins_cmd_dat {
					output-low;
					pinmux = <0x9b00>;
					slew-rate = <0x1>;
				};
			};

			state_miso_spi {
				phandle = <0xa>;

				pins_cmd_dat {
					drive-strength = <0x3>;
					pinmux = <0x9b01>;
				};
			};

			state_mosi_pullhigh {
				phandle = <0x10>;

				pins_cmd_dat {
					output-high;
					pinmux = <0x9d00>;
					slew-rate = <0x1>;
				};
			};

			state_mosi_pulllow {
				phandle = <0x11>;

				pins_cmd_dat {
					output-low;
					pinmux = <0x9d00>;
					slew-rate = <0x1>;
				};
			};

			state_mosi_spi {
				phandle = <0xf>;

				pins_cmd_dat {
					drive-strength = <0x3>;
					pinmux = <0x9d01>;
				};
			};

			state_reset_high {
				phandle = <0xd>;

				pins_cmd_dat {
					output-high;
					pinmux = <0xa900>;
					slew-rate = <0x1>;
				};
			};

			state_reset_low {
				phandle = <0xe>;

				pins_cmd_dat {
					output-low;
					pinmux = <0xa900>;
					slew-rate = <0x1>;
				};
			};
		};
	};

	fragment@15 {
		target = <0xffffffff>;

		__overlay__ {
			#address-cells = <0x1>;
			#size-cells = <0x0>;
			clock-frequency = <0x61a80>;
			mediatek,use-open-drain;

			SM5109@3e {
				compatible = "mediatek,SM5109";
				reg = <0x3e>;
				status = "okay";
			};
		};
	};

	fragment@16 {
		target = <0xffffffff>;

		__overlay__ {
			pinctrl-0 = <0x18>;
			pinctrl-1 = <0x19>;
			pinctrl-10 = <0x22>;
			pinctrl-11 = <0x23>;
			pinctrl-2 = <0x1a>;
			pinctrl-3 = <0x1b>;
			pinctrl-4 = <0x1c>;
			pinctrl-5 = <0x1d>;
			pinctrl-6 = <0x1e>;
			pinctrl-7 = <0x1f>;
			pinctrl-8 = <0x20>;
			pinctrl-9 = <0x21>;
			pinctrl-names = "lcm_rst_out0_gpio", "lcm_rst_out1_gpio", "lcm_vddi_en0_gpio", "lcm_vddi_en1_gpio", "lcm_enp_en0_gpio", "lcm_enp_en1_gpio", "lcm_enn_en0_gpio", "lcm_enn_en1_gpio", "lcm_bkg_en0_gpio", "lcm_bkg_en1_gpio", "tp_rst_out0_gpio", "tp_rst_out1_gpio";
			status = "okay";
		};
	};

	fragment@17 {
		target = <0xffffffff>;

		__overlay__ {

			lcm_bkg_en0_gpio {
				phandle = <0x20>;

				pins_cmd_dat {
					output-low;
					pinmux = <0x9600>;
					slew-rate = <0x1>;
				};
			};

			lcm_bkg_en1_gpio {
				phandle = <0x21>;

				pins_cmd_dat {
					output-high;
					pinmux = <0x9600>;
					slew-rate = <0x1>;
				};
			};

			lcm_enn_en0_gpio {
				phandle = <0x1e>;

				pins_cmd_dat {
					output-low;
					pinmux = <0x9700>;
					slew-rate = <0x1>;
				};
			};

			lcm_enn_en1_gpio {
				phandle = <0x1f>;

				pins_cmd_dat {
					output-high;
					pinmux = <0x9700>;
					slew-rate = <0x1>;
				};
			};

			lcm_enp_en0_gpio {
				phandle = <0x1c>;

				pins_cmd_dat {
					output-low;
					pinmux = <0x9800>;
					slew-rate = <0x1>;
				};
			};

			lcm_enp_en1_gpio {
				phandle = <0x1d>;

				pins_cmd_dat {
					output-high;
					pinmux = <0x9800>;
					slew-rate = <0x1>;
				};
			};

			lcm_rst_out0_gpio {
				phandle = <0x18>;

				pins_cmd_dat {
					output-low;
					pinmux = <0x2d00>;
					slew-rate = <0x1>;
				};
			};

			lcm_rst_out1_gpio {
				phandle = <0x19>;

				pins_cmd_dat {
					output-high;
					pinmux = <0x2d00>;
					slew-rate = <0x1>;
				};
			};

			lcm_vddi_en0_gpio {
				phandle = <0x1a>;

				pins_cmd_dat {
					output-low;
					pinmux = <0xa600>;
					slew-rate = <0x1>;
				};
			};

			lcm_vddi_en1_gpio {
				phandle = <0x1b>;

				pins_cmd_dat {
					output-high;
					pinmux = <0xa600>;
					slew-rate = <0x1>;
				};
			};

			tp_rst_out0_gpio {
				phandle = <0x22>;

				pins_cmd_dat {
					output-low;
					pinmux = <0xa00>;
					slew-rate = <0x1>;
				};
			};

			tp_rst_out1_gpio {
				phandle = <0x23>;

				pins_cmd_dat {
					output-high;
					pinmux = <0xa00>;
					slew-rate = <0x1>;
				};
			};
		};
	};

	fragment@18 {
		target = <0xffffffff>;

		__overlay__ {

			fp_id_gpio_down {
				phandle = <0x25>;

				pins_cmd_dat {
					bias-pull-down;
					input-enable;
					pinmux = <0xaa00>;
					slew-rate = <0x0>;
				};
			};

			fp_id_gpio_up {
				phandle = <0x24>;

				pins_cmd_dat {
					bias-pull-up;
					input-enable;
					pinmux = <0xaa00>;
					slew-rate = <0x0>;
				};
			};
		};
	};

	fragment@19 {
		target = <0xffffffff>;

		__overlay__ {
			fp_id,gpios = <0xffffffff 0xaa 0x0>;
			pinctrl-0 = <0x24>;
			pinctrl-1 = <0x25>;
			pinctrl-names = "fp_gpio_pull_up", "fp_gpio_pull_down";
			status = "okay";
			vivo,project-name = "PD2036F_EX";
		};
	};

	fragment@2 {
		target = <0xffffffff>;

		__overlay__ {

			ext_buck_lp4@57 {
				regulator-max-microvolt = <0x13d620>;
				regulator-min-microvolt = <0x493e0>;
				regulator-name = "ext_buck_vdd2";
				vsel_pin = <0x0>;
			};

			ext_buck_lp4x@50 {
				regulator-max-microvolt = <0x13d620>;
				regulator-min-microvolt = <0x493e0>;
				regulator-name = "ext_buck_vddq";
				vsel_pin = <0x1>;
			};
		};
	};

	fragment@20 {
		target = <0xffffffff>;

		__overlay__ {
			pinctrl-0 = <0x26>;
			pinctrl-1 = <0x27>;
			pinctrl-names = "irtx_gpio_led_default", "irtx_gpio_led_set";
			status = "okay";
		};
	};

	fragment@21 {
		target = <0xffffffff>;

		__overlay__ {

			irtx_gpio_led_def@gpio90 {
				phandle = <0x26>;

				pins_cmd_dat {
					bias-disable;
					input-schmitt-enable = <0x0>;
					output-low;
					pinmux = <0x5a00>;
					slew-rate = <0x1>;
				};
			};

			irtx_gpio_led_set@gpio90 {
				phandle = <0x27>;

				pins_cmd_dat {
					output-high;
					pinmux = <0x5a02>;
					slew-rate = <0x1>;
				};
			};
		};
	};

	fragment@22 {
		target = <0xffffffff>;

		__overlay__ {
			pinctrl-0 = <0x28>;
			pinctrl-1 = <0x29>;
			pinctrl-2 = <0x2a>;
			pinctrl-3 = <0x2b>;
			pinctrl-names = "aud_dat_mosi_off", "aud_dat_mosi_on", "aud_dat_miso_off", "aud_dat_miso_on", "aud_smartpa_off", "aud_smartpa_on";
			status = "okay";
		};
	};

	fragment@23 {
		target = <0xffffffff>;

		__overlay__ {

			aud_dat_miso_off {
				phandle = <0x2a>;

				pins_cmd0_dat {
					drive-strength = <0x0>;
					pinmux = <0x8c00>;
				};

				pins_cmd1_dat {
					drive-strength = <0x0>;
					pinmux = <0x8d00>;
				};

				pins_cmd2_dat {
					bias-disable;
					drive-strength = <0x0>;
					input-enable;
					pinmux = <0x8e00>;
					slew-rate = <0x0>;
				};

				pins_cmd3_dat {
					bias-disable;
					drive-strength = <0x0>;
					input-enable;
					pinmux = <0x8f00>;
					slew-rate = <0x0>;
				};
			};

			aud_dat_miso_on {
				phandle = <0x2b>;

				pins_cmd0_dat {
					drive-strength = <0x3>;
					input-schmitt-enable;
					pinmux = <0x8c01>;
				};

				pins_cmd1_dat {
					drive-strength = <0x3>;
					input-schmitt-enable;
					pinmux = <0x8d01>;
				};

				pins_cmd2_dat {
					drive-strength = <0x3>;
					input-schmitt-enable;
					pinmux = <0x8e01>;
				};

				pins_cmd3_dat {
					drive-strength = <0x3>;
					input-schmitt-enable;
					pinmux = <0x8f01>;
				};
			};

			aud_dat_mosi_off {
				phandle = <0x28>;

				pins_cmd0_dat {
					drive-strength = <0x0>;
					pinmux = <0x8800>;
				};

				pins_cmd1_dat {
					drive-strength = <0x0>;
					pinmux = <0x8900>;
				};

				pins_cmd2_dat {
					bias-disable;
					drive-strength = <0x0>;
					input-enable;
					pinmux = <0x8a00>;
					slew-rate = <0x0>;
				};

				pins_cmd3_dat {
					bias-disable;
					drive-strength = <0x0>;
					input-enable;
					pinmux = <0x8b00>;
					slew-rate = <0x0>;
				};
			};

			aud_dat_mosi_on {
				phandle = <0x29>;

				pins_cmd0_dat {
					drive-strength = <0x3>;
					input-schmitt-enable;
					pinmux = <0x8801>;
				};

				pins_cmd1_dat {
					drive-strength = <0x3>;
					input-schmitt-enable;
					pinmux = <0x8901>;
				};

				pins_cmd2_dat {
					drive-strength = <0x3>;
					input-schmitt-enable;
					pinmux = <0x8a01>;
				};

				pins_cmd3_dat {
					drive-strength = <0x3>;
					input-schmitt-enable;
					pinmux = <0x8b01>;
				};
			};
		};
	};

	fragment@24 {
		target = <0xffffffff>;

		__overlay__ {
			mt6370,intr_gpio = <0xffffffff 0xb 0x0>;
			mt6370,intr_gpio_num = <0xb>;
		};
	};

	fragment@25 {
		target = <0xffffffff>;

		__overlay__ {
			mt6370pd,intr_gpio = <0xffffffff 0x29 0x0>;
			mt6370pd,intr_gpio_num = <0x29>;
		};
	};

	fragment@26 {
		target = <0xffffffff>;

		__overlay__ {
			bc12_sel = <0x1>;
		};
	};

	fragment@27 {
		target = <0xffffffff>;

		__overlay__ {

			cam0@0 {
				phandle = <0x2d>;

				pins_cmd_dat {
					output-low;
					pinmux = <0x6500>;
					slew-rate = <0x1>;
				};
			};

			cam0@1 {
				phandle = <0x2e>;

				pins_cmd_dat {
					output-high;
					pinmux = <0x6500>;
					slew-rate = <0x1>;
				};
			};

			cam0@vcama0 {
				phandle = <0x35>;

				pins_cmd_dat {
					output-low;
					pinmux = <0x6100>;
					slew-rate = <0x1>;
				};
			};

			cam0@vcama1 {
				phandle = <0x36>;

				pins_cmd_dat {
					output-high;
					pinmux = <0x6100>;
					slew-rate = <0x1>;
				};
			};

			cam1@0 {
				phandle = <0x2f>;

				pins_cmd_dat {
					output-low;
					pinmux = <0x5700>;
					slew-rate = <0x1>;
				};
			};

			cam1@1 {
				phandle = <0x30>;

				pins_cmd_dat {
					output-high;
					pinmux = <0x5700>;
					slew-rate = <0x1>;
				};
			};

			cam1@vcama0 {
				phandle = <0x37>;

				pins_cmd_dat {
					output-low;
					pinmux = <0x6100>;
					slew-rate = <0x1>;
				};
			};

			cam1@vcama1 {
				phandle = <0x38>;

				pins_cmd_dat {
					output-high;
					pinmux = <0x6100>;
					slew-rate = <0x1>;
				};
			};

			cam2@0 {
				phandle = <0x31>;

				pins_cmd_dat {
					output-low;
					pinmux = <0x6d00>;
					slew-rate = <0x1>;
				};
			};

			cam2@1 {
				phandle = <0x32>;

				pins_cmd_dat {
					output-high;
					pinmux = <0x6d00>;
					slew-rate = <0x1>;
				};
			};

			cam2@vcama0 {
				phandle = <0x39>;

				pins_cmd_dat {
					output-low;
					pinmux = <0x6100>;
					slew-rate = <0x1>;
				};
			};

			cam2@vcama1 {
				phandle = <0x3a>;

				pins_cmd_dat {
					output-high;
					pinmux = <0x6100>;
					slew-rate = <0x1>;
				};
			};

			cam3@0 {
				phandle = <0x33>;

				pins_cmd_dat {
					output-low;
					pinmux = <0x6600>;
					slew-rate = <0x1>;
				};
			};

			cam3@1 {
				phandle = <0x34>;

				pins_cmd_dat {
					output-high;
					pinmux = <0x6600>;
					slew-rate = <0x1>;
				};
			};

			cam3@vcama0 {
				phandle = <0x3b>;

				pins_cmd_dat {
					output-low;
					pinmux = <0x6100>;
					slew-rate = <0x1>;
				};
			};

			cam3@vcama1 {
				phandle = <0x3c>;

				pins_cmd_dat {
					output-high;
					pinmux = <0x6100>;
					slew-rate = <0x1>;
				};
			};

			camdefault {
				phandle = <0x2c>;
			};

			camera_pins_cam0_mclk_off {
				phandle = <0x3e>;

				pins_cmd_dat {
					pinmux = <0x6300>;
				};
			};

			camera_pins_cam0_mclk_on {
				phandle = <0x3d>;

				pins_cmd_dat {
					pinmux = <0x6301>;
				};
			};

			camera_pins_cam1_mclk_off {
				phandle = <0x40>;

				pins_cmd_dat {
					pinmux = <0x5800>;
				};
			};

			camera_pins_cam1_mclk_on {
				phandle = <0x3f>;

				pins_cmd_dat {
					pinmux = <0x5801>;
				};
			};

			camera_pins_cam2_mclk_off {
				phandle = <0x42>;

				pins_cmd_dat {
					pinmux = <0x6c00>;
				};
			};

			camera_pins_cam2_mclk_on {
				phandle = <0x41>;

				pins_cmd_dat {
					pinmux = <0x6c01>;
				};
			};

			camera_pins_cam3_mclk_off {
				phandle = <0x44>;

				pins_cmd_dat {
					pinmux = <0x6400>;
				};
			};

			camera_pins_cam3_mclk_on {
				phandle = <0x43>;

				pins_cmd_dat {
					pinmux = <0x6401>;
				};
			};
		};
	};

	fragment@28 {
		target = <0xffffffff>;

		__overlay__ {
			pinctrl-0 = <0x2c>;
			pinctrl-1 = <0x2d>;
			pinctrl-10 = <0x36>;
			pinctrl-11 = <0x37>;
			pinctrl-12 = <0x38>;
			pinctrl-13 = <0x39>;
			pinctrl-14 = <0x3a>;
			pinctrl-15 = <0x3b>;
			pinctrl-16 = <0x3c>;
			pinctrl-17 = <0x3d>;
			pinctrl-18 = <0x3e>;
			pinctrl-19 = <0x3f>;
			pinctrl-2 = <0x2e>;
			pinctrl-20 = <0x40>;
			pinctrl-21 = <0x41>;
			pinctrl-22 = <0x42>;
			pinctrl-23 = <0x43>;
			pinctrl-24 = <0x44>;
			pinctrl-3 = <0x2f>;
			pinctrl-4 = <0x30>;
			pinctrl-5 = <0x31>;
			pinctrl-6 = <0x32>;
			pinctrl-7 = <0x33>;
			pinctrl-8 = <0x34>;
			pinctrl-9 = <0x35>;
			pinctrl-names = "default", "cam0_rst0", "cam0_rst1", "cam1_rst0", "cam1_rst1", "cam2_rst0", "cam2_rst1", "cam3_rst0", "cam3_rst1", "cam0_ldo_vcama_0", "cam0_ldo_vcama_1", "cam1_ldo_vcama_0", "cam1_ldo_vcama_1", "cam2_ldo_vcama_0", "cam2_ldo_vcama_1", "cam3_ldo_vcama_0", "cam3_ldo_vcama_1", "cam0_mclk_on", "cam0_mclk_off", "cam1_mclk_on", "cam1_mclk_off", "cam2_mclk_on", "cam2_mclk_off", "cam3_mclk_on", "cam3_mclk_off";
			status = "okay";
		};
	};

	fragment@29 {
		target = <0xffffffff>;

		__overlay__ {

			flash_irq {
				phandle = <0x48>;

				pins_cmd_dat {
					bias-disable;
					pinmux = <0x6b00>;
					slew-rate = <0x0>;
				};
			};

			flashlight_default {
				phandle = <0x45>;
			};

			hwen_high {
				phandle = <0x46>;

				pins_cmd_dat {
					output-high;
					pinmux = <0x9900>;
					slew-rate = <0x1>;
				};
			};

			hwen_low {
				phandle = <0x47>;

				pins_cmd_dat {
					output-low;
					pinmux = <0x9900>;
					slew-rate = <0x1>;
				};
			};
		};
	};

	fragment@3 {
		target = <0xffffffff>;

		__overlay__ {

			ext_buck_vgpu@55 {
				regulator-max-microvolt = <0x13d620>;
				regulator-min-microvolt = <0x493e0>;
				regulator-name = "ext_buck_vgpu";
				vsel_pin = <0x2>;
			};
		};
	};

	fragment@30 {
		target = <0xffffffff>;

		__overlay__ {
			pinctrl-0 = <0x45>;
			pinctrl-1 = <0x46>;
			pinctrl-2 = <0x47>;
			pinctrl-3 = <0x48>;
			pinctrl-names = "default", "hwen_high", "hwen_low", "flash_irq";
			status = "okay";
		};
	};

	fragment@31 {
		target = <0xffffffff>;

		__overlay__ {
			PD2036F_EX_11.0;
			fast_power_off;
		};
	};

	fragment@32 {
		target = <0xffffffff>;

		__overlay__ {

			adc_channel@ {
				compatible = "mediatek,adc_channel";
				mediatek,adc_fdd_rf_params_dynamic_custom_ch = <0x2>;
				mediatek,temperature0 = <0x0>;
				mediatek,temperature1 = <0x1>;
				status = "okay";
			};
		};
	};

	fragment@33 {
		target = <0xffffffff>;

		__overlay__ {
			mediatek,clkbuf-config = <0x2 0x1 0x2 0x2 0x0 0x0 0x0>;
			mediatek,clkbuf-driving-current = <0x1 0x1 0x1 0x1 0x1 0x1 0x1>;
			mediatek,clkbuf-quantity = <0x7>;
			status = "okay";
		};
	};

	fragment@34 {
		target = <0xffffffff>;

		__overlay__ {
			#address-cells = <0x1>;
			#size-cells = <0x0>;
			clock-frequency = <0x61a80>;
			mediatek,use-open-drain;

			cap_touch@5d {
				compatible = "mediatek,cap_touch";
				phandle = <0x62>;
				reg = <0x5d>;
				status = "okay";
			};
		};
	};

	fragment@35 {
		target = <0xffffffff>;

		__overlay__ {
			#address-cells = <0x1>;
			#size-cells = <0x0>;
			clock-frequency = <0x61a80>;
			mediatek,use-open-drain;
		};
	};

	fragment@36 {
		target = <0xffffffff>;

		__overlay__ {
			#address-cells = <0x1>;
			#size-cells = <0x0>;
			clock-frequency = <0x61a80>;
			mediatek,use-open-drain;

			camera_main@1a {
				compatible = "mediatek,camera_main";
				phandle = <0x63>;
				reg = <0x1a>;
				status = "okay";
			};

			camera_main_af@18 {
				compatible = "mediatek,camera_main_af";
				phandle = <0x67>;
				reg = <0x18>;
				status = "okay";
			};

			camera_main_eeprom@50 {
				compatible = "mediatek,camera_main_eeprom";
				phandle = <0x65>;
				reg = <0x50>;
				status = "okay";
			};

			camera_sub@2d {
				compatible = "mediatek,camera_sub";
				phandle = <0x64>;
				reg = <0x2a>;
				status = "okay";
			};

			camera_sub_eeprom@52 {
				compatible = "mediatek,camera_sub_eeprom";
				phandle = <0x66>;
				reg = <0x52>;
				status = "okay";
			};

			ccu_sensor_i2c_2_hw@33 {
				compatible = "mediatek,ccu_sensor_i2c_2_hw";
				phandle = <0x68>;
				reg = <0x33>;
				status = "okay";
			};
		};
	};

	fragment@37 {
		target = <0xffffffff>;

		__overlay__ {
			#address-cells = <0x1>;
			#size-cells = <0x0>;
			clock-frequency = <0x61a80>;
			mediatek,use-open-drain;

			ext_buck_lp4@57 {
				compatible = "mediatek,ext_buck_lp4";
				phandle = <0x69>;
				reg = <0x57>;
				status = "okay";
			};

			ext_buck_lp4x@50 {
				compatible = "mediatek,ext_buck_lp4x";
				phandle = <0x6a>;
				reg = <0x50>;
				status = "okay";
			};
		};
	};

	fragment@38 {
		target = <0xffffffff>;

		__overlay__ {
			#address-cells = <0x1>;
			#size-cells = <0x0>;
			clock-frequency = <0x61a80>;
			mediatek,use-open-drain;

			camera_main_three@2d {
				compatible = "mediatek,camera_main_three";
				phandle = <0x70>;
				reg = <0x2d>;
				status = "okay";
			};

			camera_main_three_eeprom@50 {
				compatible = "mediatek,camera_main_three_eeprom";
				phandle = <0x71>;
				reg = <0x50>;
				status = "okay";
			};

			camera_main_two@2d {
				compatible = "mediatek,camera_main_two";
				phandle = <0x6b>;
				reg = <0x2d>;
				status = "okay";
			};

			camera_main_two_af@18 {
				compatible = "mediatek,camera_main_two_af";
				phandle = <0x6d>;
				reg = <0x18>;
				status = "okay";
			};

			camera_main_two_eeprom@50 {
				compatible = "mediatek,camera_main_two_eeprom";
				phandle = <0x6c>;
				reg = <0x50>;
				status = "okay";
			};

			camera_sub_two@2d {
				compatible = "mediatek,camera_sub_two";
				phandle = <0x6e>;
				reg = <0x2d>;
				status = "okay";
			};

			camera_sub_two_eeprom@50 {
				compatible = "mediatek,camera_sub_two_eeprom";
				phandle = <0x6f>;
				reg = <0x50>;
				status = "okay";
			};

			ccu_sensor_i2c_4_hw@36 {
				compatible = "mediatek,ccu_sensor_i2c_4_hw";
				phandle = <0x72>;
				reg = <0x36>;
				status = "okay";
			};
		};
	};

	fragment@39 {
		target = <0xffffffff>;

		__overlay__ {
			#address-cells = <0x1>;
			#size-cells = <0x0>;
			clock-frequency = <0x61a80>;
			mediatek,use-open-drain;

			subpmic_pmu@34 {
				compatible = "mediatek,subpmic_pmu";
				phandle = <0x73>;
				reg = <0x34>;
				status = "okay";
			};
		};
	};

	fragment@4 {
		target = <0xffffffff>;

		__overlay__ {

			iddig_default {
				phandle = <0x49>;
			};

			iddig_gpio {
				phandle = <0x4a>;

				pins_cmd_dat {
					bias-disable;
					input-enable;
					pinmux = <0x6e00>;
					slew-rate = <0x0>;
				};
			};

			iddig_gpio_pull_down {
				phandle = <0x4b>;

				pins_cmd_dat {
					bias-pull-down;
					input-enable;
					pinmux = <0x6e00>;
					slew-rate = <0x0>;
				};
			};

			iddig_init {
				phandle = <0x52>;

				pins_cmd_dat {
					bias-disable;
					input-enable;
					pinmux = <0x6e05>;
					slew-rate = <0x0>;
				};
			};

			otg167_pull1_high {
				phandle = <0x53>;

				pins_cmd_dat {
					bias-pull-up = <0x1>;
					output-high;
					pinmux = <0xa700>;
					slew-rate = <0x1>;
				};
			};

			otg167_pull1_in {
				phandle = <0x55>;

				pins_cmd_dat {
					bias-disable;
					input-enable;
					pinmux = <0xa700>;
					slew-rate = <0x0>;
				};
			};

			otg167_pull1_low {
				phandle = <0x54>;

				pins_cmd_dat {
					output-low;
					pinmux = <0xa700>;
					slew-rate = <0x1>;
				};
			};

			otg_pull1_high {
				phandle = <0x4f>;

				pins_cmd_dat {
					bias-pull-up = <0x1>;
					output-high;
					pinmux = <0xa400>;
					slew-rate = <0x1>;
				};
			};

			otg_pull1_in {
				phandle = <0x51>;

				pins_cmd_dat {
					bias-disable;
					input-enable;
					pinmux = <0xa400>;
					slew-rate = <0x0>;
				};
			};

			otg_pull1_low {
				phandle = <0x50>;

				pins_cmd_dat {
					output-low;
					pinmux = <0xa400>;
					slew-rate = <0x1>;
				};
			};

			otg_pull_high {
				phandle = <0x4c>;

				pins_cmd_dat {
					bias-pull-up = <0x1>;
					output-high;
					pinmux = <0xa500>;
					slew-rate = <0x1>;
				};
			};

			otg_pull_in {
				phandle = <0x4e>;

				pins_cmd_dat {
					bias-disable;
					input-enable;
					pinmux = <0xa500>;
					slew-rate = <0x0>;
				};
			};

			otg_pull_low {
				phandle = <0x4d>;

				pins_cmd_dat {
					output-low;
					pinmux = <0xa500>;
					slew-rate = <0x1>;
				};
			};
		};
	};

	fragment@40 {
		target = <0xffffffff>;

		__overlay__ {
			#address-cells = <0x1>;
			#size-cells = <0x0>;
			clock-frequency = <0x61a80>;
			mediatek,use-open-drain;

			ext_buck_vgpu@55 {
				compatible = "mediatek,ext_buck_vgpu";
				phandle = <0x74>;
				reg = <0x55>;
				status = "okay";
			};

			strobe_main@63 {
				compatible = "mediatek,strobe_main";
				reg = <0x63>;
				status = "okay";
			};
		};
	};

	fragment@41 {
		target = <0xffffffff>;

		__overlay__ {
			#address-cells = <0x1>;
			#size-cells = <0x0>;
			clock-frequency = <0x61a80>;
			mediatek,use-open-drain;
		};
	};

	fragment@42 {
		target = <0xffffffff>;

		__overlay__ {
			#address-cells = <0x1>;
			#size-cells = <0x0>;
			clock-frequency = <0x61a80>;
			mediatek,use-open-drain;
		};
	};

	fragment@43 {
		target = <0xffffffff>;

		__overlay__ {
			#address-cells = <0x1>;
			#size-cells = <0x0>;
			clock-frequency = <0x61a80>;
			mediatek,use-open-drain;
		};
	};

	fragment@44 {
		target = <0xffffffff>;

		__overlay__ {
			GPIO_FDD_BAND_SUPPORT_DETECT_1ST_PIN = <0xffffffff 0xb1 0x0>;
			GPIO_FDD_BAND_SUPPORT_DETECT_2ND_PIN = <0xffffffff 0xb0 0x0>;
			GPIO_FDD_BAND_SUPPORT_DETECT_3RD_PIN = <0xffffffff 0xaf 0x0>;
			GPIO_FDD_BAND_SUPPORT_DETECT_4TH_PIN = <0xffffffff 0xae 0x0>;
			GPIO_FDD_BAND_SUPPORT_DETECT_5TH_PIN = <0xffffffff 0xb2 0x0>;
			GPIO_SIM1_HOT_PLUG = <0xffffffff 0x2f 0x0>;
			GPIO_SIM1_SCLK = <0xffffffff 0x26 0x0>;
			GPIO_SIM1_SIO = <0xffffffff 0x28 0x0>;
			GPIO_SIM1_SRST = <0xffffffff 0x27 0x0>;
			GPIO_SIM2_SCLK = <0xffffffff 0x25 0x0>;
			GPIO_SIM2_SIO = <0xffffffff 0x23 0x0>;
			GPIO_SIM2_SRST = <0xffffffff 0x24 0x0>;
		};
	};

	fragment@45 {
		target = <0xffffffff>;

		__overlay__ {
			gpio_init_default = <0x0 0x0 0x0 0x0 0x0 0x1 0x1 0x1 0x0 0x0 0x0 0x0 0x0 0x1 0x2 0x0 0x0 0x0 0x1 0x1 0x1 0x3 0x0 0x0 0x0 0x1 0x1 0x1 0x4 0x0 0x0 0x0 0x1 0x1 0x0 0x5 0x0 0x0 0x0 0x1 0x0 0x0 0x6 0x0 0x0 0x0 0x1 0x1 0x0 0x7 0x0 0x0 0x0 0x1 0x0 0x0 0x8 0x0 0x0 0x0 0x1 0x1 0x0 0x9 0x0 0x0 0x0 0x1 0x1 0x0 0xa 0x0 0x1 0x0 0x0 0x0 0x0 0xb 0x0 0x0 0x0 0x1 0x1 0x0 0xc 0x0 0x0 0x0 0x1 0x0 0x0 0xd 0x3 0x0 0x0 0x1 0x0 0x0 0xe 0x3 0x1 0x0 0x0 0x0 0x0 0xf 0x3 0x1 0x0 0x0 0x0 0x0 0x10 0x3 0x1 0x0 0x0 0x0 0x0 0x11 0x2 0x0 0x0 0x1 0x0 0x0 0x12 0x2 0x0 0x0 0x1 0x0 0x0 0x13 0x2 0x0 0x0 0x0 0x0 0x0 0x14 0x2 0x0 0x0 0x1 0x0 0x0 0x15 0x0 0x1 0x1 0x0 0x0 0x0 0x16 0x0 0x0 0x0 0x1 0x0 0x0 0x17 0x0 0x0 0x0 0x1 0x0 0x0 0x18 0x0 0x0 0x0 0x1 0x0 0x0 0x19 0x0 0x0 0x0 0x1 0x0 0x0 0x1a 0x0 0x0 0x0 0x1 0x0 0x0 0x1b 0x0 0x0 0x0 0x1 0x0 0x0 0x1c 0x1 0x1 0x0 0x1 0x1 0x0 0x1d 0x1 0x1 0x0 0x0 0x0 0x1 0x1e 0x1 0x0 0x0 0x1 0x1 0x1 0x1f 0x1 0x0 0x0 0x1 0x1 0x1 0x20 0x1 0x0 0x0 0x1 0x1 0x1 0x21 0x1 0x0 0x0 0x1 0x1 0x1 0x22 0x1 0x0 0x0 0x1 0x1 0x1 0x23 0x1 0x0 0x0 0x1 0x1 0x0 0x24 0x1 0x1 0x0 0x0 0x0 0x0 0x25 0x1 0x1 0x0 0x0 0x0 0x0 0x26 0x1 0x1 0x0 0x0 0x0 0x0 0x27 0x1 0x1 0x0 0x0 0x0 0x0 0x28 0x1 0x0 0x0 0x1 0x1 0x0 0x29 0x0 0x0 0x0 0x0 0x0 0x0 0x2a 0x0 0x0 0x0 0x1 0x0 0x0 0x2b 0x1 0x1 0x0 0x0 0x0 0x0 0x2c 0x1 0x0 0x0 0x1 0x0 0x0 0x2d 0x0 0x1 0x0 0x0 0x0 0x0 0x2e 0x0 0x0 0x0 0x0 0x0 0x0 0x2f 0x1 0x0 0x0 0x0 0x0 0x0 0x30 0x1 0x0 0x0 0x1 0x1 0x1 0x31 0x1 0x0 0x0 0x1 0x1 0x1 0x32 0x1 0x0 0x0 0x1 0x1 0x1 0x33 0x1 0x1 0x0 0x1 0x1 0x1 0x34 0x1 0x1 0x0 0x1 0x0 0x0 0x35 0x1 0x1 0x0 0x1 0x0 0x0 0x36 0x1 0x1 0x0 0x1 0x0 0x0 0x37 0x1 0x1 0x0 0x1 0x0 0x0 0x38 0x1 0x1 0x0 0x1 0x0 0x0 0x39 0x1 0x1 0x0 0x1 0x0 0x0 0x3a 0x0 0x0 0x0 0x1 0x0 0x0 0x3b 0x1 0x0 0x0 0x1 0x0 0x0 0x3c 0x1 0x0 0x0 0x1 0x0 0x0 0x3d 0x1 0x0 0x0 0x1 0x0 0x0 0x3e 0x1 0x0 0x0 0x1 0x0 0x0 0x3f 0x1 0x0 0x0 0x1 0x0 0x0 0x40 0x1 0x0 0x0 0x1 0x0 0x0 0x41 0x1 0x0 0x0 0x1 0x0 0x0 0x42 0x1 0x0 0x0 0x1 0x0 0x0 0x43 0x1 0x0 0x0 0x1 0x0 0x0 0x44 0x1 0x0 0x0 0x1 0x0 0x0 0x45 0x1 0x1 0x0 0x1 0x0 0x0 0x46 0x1 0x1 0x0 0x1 0x0 0x0 0x47 0x1 0x1 0x0 0x1 0x0 0x0 0x48 0x1 0x1 0x0 0x1 0x0 0x0 0x49 0x0 0x1 0x0 0x1 0x0 0x0 0x4a 0x0 0x1 0x0 0x1 0x0 0x0 0x4b 0x0 0x0 0x0 0x1 0x0 0x0 0x4c 0x1 0x1 0x0 0x1 0x0 0x0 0x4d 0x1 0x1 0x0 0x1 0x0 0x0 0x4e 0x1 0x1 0x0 0x1 0x0 0x0 0x4f 0x0 0x0 0x0 0x1 0x0 0x0 0x50 0x0 0x0 0x0 0x1 0x0 0x0 0x51 0x1 0x0 0x0 0x1 0x1 0x1 0x52 0x1 0x0 0x0 0x1 0x1 0x1 0x53 0x1 0x0 0x0 0x1 0x1 0x1 0x54 0x1 0x0 0x0 0x1 0x1 0x1 0x55 0x1 0x1 0x0 0x1 0x0 0x0 0x56 0x1 0x1 0x0 0x1 0x0 0x0 0x57 0x0 0x1 0x0 0x0 0x0 0x0 0x58 0x0 0x0 0x0 0x1 0x0 0x0 0x59 0x1 0x0 0x0 0x1 0x0 0x0 0x5a 0x0 0x0 0x0 0x1 0x0 0x0 0x5b 0x0 0x1 0x0 0x1 0x0 0x0 0x5c 0x0 0x0 0x0 0x1 0x0 0x0 0x5d 0x1 0x0 0x0 0x1 0x1 0x0 0x5e 0x0 0x0 0x0 0x1 0x0 0x0 0x5f 0x1 0x0 0x0 0x1 0x1 0x0 0x60 0x1 0x1 0x0 0x0 0x0 0x0 0x61 0x0 0x1 0x0 0x0 0x0 0x0 0x62 0x0 0x1 0x0 0x0 0x0 0x0 0x63 0x0 0x1 0x0 0x0 0x0 0x0 0x64 0x0 0x1 0x0 0x0 0x0 0x0 0x65 0x0 0x1 0x0 0x0 0x0 0x0 0x66 0x0 0x1 0x0 0x0 0x0 0x0 0x67 0x1 0x0 0x0 0x1 0x1 0x1 0x68 0x1 0x0 0x0 0x1 0x1 0x1 0x69 0x1 0x0 0x0 0x1 0x1 0x1 0x6a 0x1 0x0 0x0 0x1 0x1 0x1 0x6b 0x0 0x0 0x0 0x1 0x1 0x0 0x6c 0x0 0x1 0x0 0x0 0x0 0x0 0x6d 0x0 0x1 0x0 0x0 0x0 0x0 0x6e 0x0 0x0 0x0 0x1 0x1 0x0 0x6f 0x0 0x0 0x0 0x1 0x0 0x0 0x70 0x0 0x0 0x0 0x1 0x0 0x0 0x71 0x0 0x1 0x0 0x0 0x0 0x0 0x72 0x0 0x0 0x0 0x1 0x0 0x0 0x73 0x0 0x0 0x0 0x1 0x0 0x0 0x74 0x0 0x0 0x0 0x1 0x0 0x0 0x75 0x0 0x0 0x0 0x1 0x0 0x0 0x76 0x0 0x0 0x0 0x1 0x0 0x0 0x77 0x0 0x0 0x0 0x1 0x0 0x0 0x78 0x0 0x0 0x0 0x1 0x0 0x0 0x79 0x0 0x0 0x0 0x0 0x0 0x0 0x7a 0x1 0x0 0x0 0x1 0x1 0x1 0x7b 0x1 0x0 0x0 0x1 0x1 0x1 0x7c 0x1 0x1 0x0 0x0 0x0 0x1 0x7d 0x1 0x0 0x0 0x1 0x1 0x1 0x7e 0x1 0x0 0x0 0x1 0x1 0x1 0x7f 0x1 0x0 0x0 0x1 0x1 0x1 0x80 0x1 0x0 0x0 0x1 0x1 0x1 0x81 0x1 0x0 0x0 0x1 0x1 0x1 0x82 0x1 0x0 0x0 0x1 0x1 0x1 0x83 0x1 0x0 0x0 0x1 0x0 0x1 0x84 0x1 0x0 0x0 0x1 0x1 0x1 0x85 0x1 0x1 0x1 0x0 0x0 0x1 0x86 0x1 0x0 0x0 0x1 0x0 0x1 0x87 0x1 0x1 0x0 0x0 0x0 0x0 0x88 0x1 0x1 0x0 0x0 0x0 0x0 0x89 0x1 0x1 0x0 0x0 0x0 0x0 0x8a 0x1 0x1 0x0 0x0 0x0 0x0 0x8b 0x1 0x1 0x0 0x0 0x0 0x0 0x8c 0x1 0x0 0x0 0x1 0x0 0x0 0x8d 0x1 0x0 0x0 0x1 0x0 0x0 0x8e 0x1 0x0 0x0 0x1 0x0 0x0 0x8f 0x1 0x0 0x0 0x1 0x0 0x0 0x90 0x1 0x0 0x0 0x1 0x0 0x0 0x91 0x1 0x1 0x1 0x0 0x0 0x0 0x92 0x1 0x0 0x0 0x1 0x0 0x0 0x93 0x1 0x1 0x0 0x0 0x0 0x0 0x94 0x1 0x1 0x0 0x0 0x0 0x0 0x95 0x1 0x1 0x0 0x0 0x0 0x0 0x96 0x0 0x1 0x0 0x1 0x1 0x0 0x97 0x0 0x1 0x0 0x0 0x0 0x0 0x98 0x0 0x1 0x0 0x0 0x0 0x0 0x99 0x0 0x1 0x0 0x0 0x0 0x0 0x9a 0x0 0x1 0x0 0x0 0x0 0x0 0x9b 0x0 0x1 0x0 0x1 0x0 0x0 0x9c 0x0 0x1 0x0 0x0 0x0 0x0 0x9d 0x1 0x0 0x0 0x1 0x0 0x0 0x9e 0x1 0x0 0x0 0x1 0x0 0x0 0x9f 0x0 0x1 0x1 0x0 0x0 0x0 0xa0 0x0 0x0 0x0 0x1 0x0 0x0 0xa1 0x1 0x0 0x0 0x1 0x1 0x1 0xa2 0x1 0x0 0x0 0x1 0x1 0x1 0xa3 0x0 0x1 0x0 0x0 0x0 0x0 0xa4 0x0 0x0 0x0 0x0 0x0 0x0 0xa5 0x0 0x0 0x0 0x0 0x0 0x0 0xa6 0x0 0x1 0x0 0x1 0x0 0x0 0xa7 0x0 0x0 0x0 0x1 0x0 0x0 0xa8 0x0 0x0 0x0 0x1 0x0 0x0 0xa9 0x0 0x1 0x0 0x0 0x0 0x0 0xaa 0x0 0x1 0x0 0x0 0x0 0x0 0xab 0x0 0x0 0x0 0x1 0x1 0x0 0xac 0x0 0x0 0x0 0x1 0x1 0x0 0xad 0x0 0x0 0x0 0x1 0x1 0x0 0xae 0x0 0x0 0x0 0x1 0x1 0x0 0xaf 0x0 0x0 0x0 0x1 0x1 0x0 0xb0 0x0 0x0 0x0 0x1 0x1 0x0 0xb1 0x0 0x0 0x0 0x1 0x1 0x0 0xb2 0x0 0x1 0x0 0x0 0x0 0x0 0xb3 0x0 0x0 0x0 0x1 0x0 0x0>;
		};
	};

	fragment@46 {
		target = <0xffffffff>;

		__overlay__ {
			interrupt-parent = <0xffffffff>;
			interrupts = <0x0 0x2 0x0 0x0>;
			status = "okay";
		};
	};

	fragment@47 {
		target = <0xffffffff>;

		__overlay__ {
			interrupt-parent = <0xffffffff>;
			interrupts = <0x1 0x2 0x1 0x0>;
			status = "okay";
		};
	};

	fragment@48 {
		target = <0xffffffff>;

		__overlay__ {
			deb-gpios = <0xffffffff 0x2 0x0>;
			debounce = <0x7d000>;
			interrupt-parent = <0xffffffff>;
			interrupts = <0x2 0x8 0x2 0x0>;
			status = "okay";
		};
	};

	fragment@49 {
		target = <0xffffffff>;

		__overlay__ {
			deb-gpios = <0xffffffff 0x4 0x0>;
			deb-rgpios = <0xffffffff 0x3 0x0>;
			debounce = <0x3e800>;
			debounce1 = <0x3e800>;
			interrupt-parent = <0xffffffff>;
			interrupts = <0x4 0x8 0x3 0x8>;
			status = "okay";
		};
	};

	fragment@5 {
		target = <0xffffffff>;

		__overlay__ {

			spi_driving_set {
				phandle = <0x61>;

				pin_cmd_dat {
					drive-strength = <0x2>;
					pinmux = <0x1100 0x1200 0x1300 0x1400>;
				};
			};
		};
	};

	fragment@50 {
		target = <0xffffffff>;

		__overlay__ {
			interrupt-parent = <0xffffffff>;
			interrupts = <0xa 0x4 0xa 0x0>;
			status = "okay";
		};
	};

	fragment@51 {
		target = <0xffffffff>;

		__overlay__ {
			interrupt-parent = <0xffffffff>;
			interrupts = <0xb 0x2 0xb 0x0>;
			status = "okay";
		};
	};

	fragment@52 {
		target = <0xffffffff>;

		__overlay__ {
			interrupt-parent = <0xffffffff>;
			interrupts = <0x6e 0x8 0x6e 0x0>;
			mtk,otg_chip_compatible_mode;
			pinctrl-0 = <0x49>;
			pinctrl-1 = <0x4a>;
			pinctrl-10 = <0x53>;
			pinctrl-11 = <0x54>;
			pinctrl-12 = <0x55>;
			pinctrl-2 = <0x4b>;
			pinctrl-3 = <0x4c>;
			pinctrl-4 = <0x4d>;
			pinctrl-5 = <0x4e>;
			pinctrl-6 = <0x4f>;
			pinctrl-7 = <0x50>;
			pinctrl-8 = <0x51>;
			pinctrl-9 = <0x52>;
			pinctrl-names = "iddig_default", "iddig_otg_gpio", "iddig_otg_gpio_pull_down", "otg_gpio_pull_high", "otg_gpio_pull_low", "otg_gpio_pull_in", "otg_gpio_pull1_high", "otg_gpio_pull1_low", "otg_gpio_pull1_in", "iddig_otg_init", "otg_gpio167_pull_high", "otg_gpio167_pull_low", "otg_gpio167_pull_in";
			platform-id = <0xffffffff 0xab 0x1>;
			status = "okay";
			usbid-num = <0xffffffff 0x6e 0x1>;
			usbid2-num = <0xffffffff 0xa7 0x1>;
		};
	};

	fragment@53 {
		target = <0xffffffff>;

		__overlay__ {
			compatible = "vivo,battery_id";
			io-channel-names = "battery_id_adc";
			io-channels = <0xffffffff 0x3>;
			status = "okay";
			vivo,bat-adc-ctrl-gpio = <0xffffffff 0x9f 0x0>;
			vivo,bat-name = "B-O5 LW 5000", "B-O5 LW 5000", "B-O5 SDI 5000", "B-O5 ATL 5000", "UNKNOWN";
		};
	};

	fragment@54 {
		target = <0xffffffff>;

		__overlay__ {
			compatible = "vivo,battery";
			io-channel-names = "primary_board_therm", "parallel_board_therm";
			io-channels = <0xffffffff 0x0 0xffffffff 0x1>;
			status = "okay";
			vivo,full-sync-cumulative = <0x3>;
			vivo,low-volt-threshold = <0xd48>;
			vivo,percnet-sync-cumulative = <0x9>;
			vivo,percnet-sync-delta = <0x4>;
			vivo,soft-rise-cumulative = <0xa>;
			vivo,soft-rise-keep-cumulative = <0xe>;
			vivo,soft-rise-percent = <0x5c>;
			vivo,soft-term-cumulative = <0x30>;
			vivo,soft-term-percent = <0x63>;
		};
	};

	fragment@55 {
		target = <0xffffffff>;

		__overlay__ {
			compatible = "vivo,charge";
			status = "okay";
			vivo,boostv-ilimit-ma = <0x5dc>;
			vivo,boostv-voltage-mv = <0x141e>;
			vivo,charge-scheme = <0x0>;
			vivo,chg-wdt-s = <0x28>;
			vivo,direct-charger-enable;
			vivo,fastchg-spec-ma = <0x7d0 0x834 0xed8>;
			vivo,ffc-full-ibat-table = <0x96 0x15d 0xfffffc2c 0x15e 0x1c1 0xfffffb68>;
			vivo,ffc-full-ibat-table-size = <0x2>;
			vivo,ffc-full-vbat-table = <0x1180 0x118a 0x116c>;
			vivo,ffc-full-vbat-table-size = <0x3>;
			vivo,ffc-iterm-ma = <0xfffffd12>;
			vivo,ffc-temperature-range = <0x96 0x1c2>;
			vivo,ffc-vreg-mv = <0x1194>;
			vivo,flashchg-spec-ma = <0x7d0 0xce4 0x1770>;
			vivo,iprechg-current-ma = <0x12c>;
			vivo,iterm-current-ma = <0x100>;
			vivo,normalchg-spec-ma = <0x7d0 0x5dc 0x8fc>;
			vivo,ovp-voltage-mv = <0x36b0>;
			vivo,parallel-ichg-max-ma = <0x6cc>;
			vivo,prechg-voltage-mv = <0xce4>;
			vivo,primary-ichg-max-ma = <0x8c0>;
			vivo,re-chg-voltage-mv = <0x64>;
			vivo,supported-adapter = <0x0>;
			vivo,sys-voltage-min-mv = <0xce4>;
			vivo,usboe-gpio = <0xffffffff 0xa3 0x0>;
			vivo,vbus-detect-source = <0x0>;
			vivo,vindpm-voltage-mv = <0x1194>;
			vivo,vreg-voltage-mv = <0x114e>;
		};
	};

	fragment@56 {
		target = <0xffffffff>;

		__overlay__ {
			compatible = "vivo,meter";
			status = "okay";
			vivo,bats-qmax = <0xcf8 0xf28 0x11ee 0x1248 0x128e 0xcf8 0xf28 0x11ee 0x1248 0x128e 0xbb8 0xccb 0xe74 0x125c 0x1270 0x1068 0x109a 0x1162 0x125c 0x127a 0x992 0xbe4 0xc1c 0xc8e 0xcc4 0x992 0xbe4 0xc1c 0xc8e 0xcc4>;
			vivo,battery-aging-support = <0x2>;
			vivo,capacity-mAh = <0x132e>;
			vivo,car-tune-value = <0x3db 0x3e8 0x3d8 0x3e8 0x3db 0x3e8 0x3d8 0x3e8 0x3c0 0x3e8 0x3d4 0x3e8 0x3e8 0x3e8 0x3e8 0x3e8 0x3e8 0x3e8 0x3e8 0x3e8 0x3e8 0x3e8 0x3e8 0x3e8>;
			vivo,car-volt-delta = <0x6>;
			vivo,load-capacity-delta-max = <0x3c>;
			vivo,meter-res-compesate = <0xa>;
			vivo,ocv-board-compesate = <0x0>;
			vivo,poweron-delta-capacity = <0x14>;
			vivo,poweron-low-capacity = <0x3>;
			vivo,volt-car-delta = <0x8>;
			vivo_battery0_profile_t0 = <0x0 0x10c5 0x135 0x1 0x10b7 0x136 0x2 0x10a9 0x139 0x3 0x109c 0x13a 0x4 0x108e 0x13a 0x5 0x1081 0x13b 0x6 0x1074 0x13b 0x7 0x1067 0x13c 0x8 0x1061 0x13b 0x9 0x105b 0x13a 0xa 0x104e 0x13b 0xb 0x1042 0x139 0xc 0x1036 0x138 0xd 0x102a 0x138 0xe 0x101e 0x139 0xf 0x1012 0x138 0x10 0x1007 0x137 0x11 0x1002 0x138 0x12 0xffc 0x138 0x13 0xff2 0x136 0x14 0xfe7 0x136 0x15 0xfdb 0x136 0x16 0xfcf 0x136 0x17 0xfc2 0x136 0x18 0xfb6 0x136 0x19 0xfaa 0x136 0x1a 0xfa4 0x136 0x1b 0xf9e 0x136 0x1c 0xf93 0x136 0x1d 0xf88 0x137 0x1e 0xf7d 0x136 0x1f 0xf70 0x137 0x20 0xf63 0x138 0x21 0xf56 0x139 0x22 0xf4a 0x13a 0x23 0xf45 0x13c 0x24 0xf3f 0x13c 0x25 0xf35 0x13d 0x26 0xf2c 0x13f 0x27 0xf24 0x13f 0x28 0xf1d 0x141 0x29 0xf16 0x142 0x2a 0xf10 0x143 0x2b 0xf09 0x145 0x2c 0xf06 0x146 0x2d 0xf03 0x149 0x2e 0xefe 0x14a 0x2f 0xef8 0x14d 0x30 0xef3 0x14e 0x31 0xeee 0x14f 0x32 0xeea 0x151 0x33 0xee5 0x153 0x34 0xee1 0x156 0x35 0xedf 0x158 0x36 0xedd 0x15b 0x37 0xed9 0x15d 0x38 0xed5 0x160 0x39 0xed3 0x163 0x3a 0xed0 0x164 0x3b 0xece 0x166 0x3c 0xecd 0x16c 0x3d 0xecb 0x16e 0x3e 0xeca 0x171 0x3f 0xec9 0x175 0x40 0xec7 0x178 0x41 0xec5 0x17b 0x42 0xec3 0x17e 0x43 0xec0 0x17f 0x44 0xebd 0x181 0x45 0xeba 0x184 0x46 0xeb8 0x187 0x47 0xeb6 0x18b 0x48 0xeb1 0x18e 0x49 0xeac 0x192 0x4a 0xea7 0x196 0x4b 0xea0 0x198 0x4c 0xe99 0x199 0x4d 0xe93 0x19c 0x4e 0xe8c 0x1a3 0x4f 0xe88 0x1a7 0x50 0xe84 0x1ad 0x51 0xe7b 0x1b3 0x52 0xe73 0x1b7 0x53 0xe6d 0x1bc 0x54 0xe69 0x1bf 0x55 0xe65 0x1c3 0x56 0xe62 0x1c5 0x57 0xe5e 0x1c8 0x58 0xe5b 0x1cd 0x59 0xe58 0x1d4 0x5a 0xe4b 0x1d7 0x5b 0xe31 0x1df 0x5c 0xe1a 0x1e3 0x5d 0xe06 0x1e7 0x5e 0xded 0x1eb 0x5f 0xdd4 0x1f2 0x60 0xdb6 0x1f4 0x61 0xd98 0x1f8 0x62 0xd7a 0x1f4 0x63 0xd5c 0x203 0x64 0xd48 0x212>;
			vivo_battery0_profile_t0_num = <0x65>;
			vivo_battery0_profile_t1 = <0x0 0x10ef 0xb2 0x1 0x10e3 0xb3 0x2 0x10dd 0xb5 0x3 0x10d7 0xb5 0x4 0x10ca 0xb6 0x5 0x10bd 0xb6 0x6 0x10b1 0xb7 0x7 0x10a5 0xb7 0x8 0x1098 0xb7 0x9 0x108b 0xb5 0xa 0x107e 0xb5 0xb 0x1072 0xb2 0xc 0x1066 0xb4 0xd 0x105a 0xb5 0xe 0x1054 0xb4 0xf 0x104d 0xb4 0x10 0x1041 0xb4 0x11 0x1036 0xb4 0x12 0x102a 0xb3 0x13 0x101e 0xb3 0x14 0x1013 0xb3 0x15 0x1007 0xb4 0x16 0xffc 0xb3 0x17 0xff2 0xb4 0x18 0xfe8 0xb2 0x19 0xfdd 0xb2 0x1a 0xfd8 0xb3 0x1b 0xfd1 0xb3 0x1c 0xfc5 0xb3 0x1d 0xfba 0xb3 0x1e 0xfaf 0xb3 0x1f 0xfa4 0xb3 0x20 0xf99 0xb3 0x21 0xf8e 0xb4 0x22 0xf83 0xb4 0x23 0xf75 0xb5 0x24 0xf67 0xb5 0x25 0xf5a 0xb6 0x26 0xf54 0xb7 0x27 0xf4e 0xb6 0x28 0xf44 0xb8 0x29 0xf3b 0xb8 0x2a 0xf32 0xb8 0x2b 0xf2b 0xb9 0x2c 0xf24 0xb9 0x2d 0xf1d 0xba 0x2e 0xf17 0xba 0x2f 0xf11 0xbb 0x30 0xf0b 0xbc 0x31 0xf05 0xbd 0x32 0xf02 0xbe 0x33 0xf00 0xc0 0x34 0xefb 0xc1 0x35 0xef6 0xc2 0x36 0xef2 0xc1 0x37 0xeed 0xc1 0x38 0xee9 0xc3 0x39 0xee5 0xc4 0x3a 0xee1 0xc6 0x3b 0xedd 0xc7 0x3c 0xeda 0xc9 0x3d 0xed6 0xcb 0x3e 0xed4 0xcc 0x3f 0xed3 0xcf 0x40 0xed0 0xd1 0x41 0xecd 0xd5 0x42 0xecb 0xd7 0x43 0xec9 0xd8 0x44 0xec7 0xda 0x45 0xec5 0xdc 0x46 0xec3 0xdd 0x47 0xebf 0xde 0x48 0xebc 0xe0 0x49 0xeb7 0xe1 0x4a 0xeb5 0xe4 0x4b 0xeb3 0xe5 0x4c 0xeae 0xe6 0x4d 0xea9 0xe8 0x4e 0xea3 0xe9 0x4f 0xe9b 0xe9 0x50 0xe95 0xeb 0x51 0xe8e 0xed 0x52 0xe86 0xf0 0x53 0xe7d 0xf4 0x54 0xe75 0xf7 0x55 0xe71 0xf7 0x56 0xe70 0xfb 0x57 0xe6e 0xfd 0x58 0xe6b 0x100 0x59 0xe68 0x104 0x5a 0xe64 0x106 0x5b 0xe5b 0x108 0x5c 0xe44 0x10b 0x5d 0xe1b 0x110 0x5e 0xde1 0x115 0x5f 0xdca 0x11c 0x60 0xdb8 0x125 0x61 0xd9d 0x12e 0x62 0xd82 0x13a 0x63 0xd62 0x149 0x64 0xd48 0x156>;
			vivo_battery0_profile_t1_num = <0x65>;
			vivo_battery0_profile_t2 = <0x0 0x1127 0xa6 0x1 0x1117 0xa6 0x2 0x110a 0xa6 0x3 0x10ff 0xa6 0x4 0x10f3 0xa7 0x5 0x10e7 0xa6 0x6 0x10db 0xa6 0x7 0x10d5 0xa6 0x8 0x10ce 0xa6 0x9 0x10c2 0xa6 0xa 0x10b5 0xa5 0xb 0x10a9 0xa4 0xc 0x109c 0xa4 0xd 0x1090 0xa3 0xe 0x1083 0xa3 0xf 0x1077 0xa2 0x10 0x106a 0xa2 0x11 0x105e 0xa2 0x12 0x1052 0xa1 0x13 0x1046 0xa1 0x14 0x1040 0xa1 0x15 0x103a 0xa1 0x16 0x102e 0xa0 0x17 0x1023 0x9f 0x18 0x1017 0x9f 0x19 0x100c 0x9f 0x1a 0x1001 0x9f 0x1b 0xff5 0x9e 0x1c 0xfeb 0x9e 0x1d 0xfe1 0x9e 0x1e 0xfd6 0x9e 0x1f 0xfca 0x9e 0x20 0xfbf 0x9e 0x21 0xfba 0x9e 0x22 0xfb4 0x9e 0x23 0xfa9 0x9e 0x24 0xf9e 0x9e 0x25 0xf94 0x9e 0x26 0xf88 0x9f 0x27 0xf7b 0x9f 0x28 0xf6d 0x9f 0x29 0xf5f 0x9f 0x2a 0xf53 0xa0 0x2b 0xf48 0xa0 0x2c 0xf3e 0xa1 0x2d 0xf36 0xa0 0x2e 0xf32 0xa1 0x2f 0xf2e 0xa1 0x30 0xf27 0xa2 0x31 0xf20 0xa2 0x32 0xf19 0xa3 0x33 0xf13 0xa4 0x34 0xf0d 0xa4 0x35 0xf08 0xa4 0x36 0xf02 0xa5 0x37 0xefd 0xa6 0x38 0xef8 0xa7 0x39 0xef3 0xa8 0x3a 0xeee 0xa8 0x3b 0xeec 0xa9 0x3c 0xeea 0xaa 0x3d 0xee6 0xab 0x3e 0xee2 0xac 0x3f 0xede 0xad 0x40 0xeda 0xae 0x41 0xed7 0xaf 0x42 0xed4 0xb1 0x43 0xed0 0xb2 0x44 0xecd 0xb3 0x45 0xeca 0xb4 0x46 0xec8 0xb5 0x47 0xec5 0xb7 0x48 0xec4 0xb8 0x49 0xec3 0xb8 0x4a 0xec1 0xb9 0x4b 0xebe 0xbb 0x4c 0xeba 0xbc 0x4d 0xeb6 0xbd 0x4e 0xeb1 0xbd 0x4f 0xead 0xbf 0x50 0xea9 0xc0 0x51 0xea3 0xc2 0x52 0xe9d 0xc2 0x53 0xe96 0xc4 0x54 0xe8f 0xc6 0x55 0xe8c 0xc6 0x56 0xe89 0xc7 0x57 0xe80 0xc9 0x58 0xe77 0xca 0x59 0xe71 0xcd 0x5a 0xe6e 0xcf 0x5b 0xe6c 0xd1 0x5c 0xe69 0xd3 0x5d 0xe66 0xd5 0x5e 0xe62 0xd8 0x5f 0xe57 0xdc 0x60 0xe3b 0xe2 0x61 0xe0c 0xe7 0x62 0xded 0xeb 0x63 0xdcd 0xef 0x64 0xd48 0xfb>;
			vivo_battery0_profile_t2_num = <0x65>;
			vivo_battery0_profile_t3 = <0x0 0x1123 0x5e 0x1 0x1118 0x5e 0x2 0x110a 0x5e 0x3 0x10f9 0x5e 0x4 0x10ee 0x5e 0x5 0x10e3 0x5e 0x6 0x10d7 0x5f 0x7 0x10cb 0x5e 0x8 0x10c5 0x5e 0x9 0x10bf 0x5e 0xa 0x10b3 0x5f 0xb 0x10a6 0x5f 0xc 0x109a 0x5e 0xd 0x108e 0x5e 0xe 0x1081 0x5e 0xf 0x1075 0x5e 0x10 0x1069 0x5e 0x11 0x105d 0x5e 0x12 0x1051 0x5e 0x13 0x1045 0x5e 0x14 0x1039 0x5e 0x15 0x102d 0x5e 0x16 0x1021 0x5e 0x17 0x1016 0x5d 0x18 0x100a 0x5e 0x19 0xfff 0x5e 0x1a 0xff4 0x5e 0x1b 0xfe9 0x5d 0x1c 0xfdf 0x5e 0x1d 0xfd4 0x5d 0x1e 0xfca 0x5e 0x1f 0xfc5 0x5d 0x20 0xfc0 0x5d 0x21 0xfb6 0x5d 0x22 0xfac 0x5e 0x23 0xfa2 0x5e 0x24 0xf98 0x5e 0x25 0xf8e 0x5d 0x26 0xf83 0x5e 0x27 0xf76 0x5d 0x28 0xf67 0x5e 0x29 0xf59 0x5d 0x2a 0xf4d 0x5d 0x2b 0xf43 0x5d 0x2c 0xf3b 0x5d 0x2d 0xf33 0x5d 0x2e 0xf2c 0x5c 0x2f 0xf25 0x5d 0x30 0xf1f 0x5d 0x31 0xf19 0x5d 0x32 0xf13 0x5d 0x33 0xf0e 0x5d 0x34 0xf08 0x5d 0x35 0xf03 0x5d 0x36 0xefe 0x5d 0x37 0xef9 0x5d 0x38 0xef5 0x5d 0x39 0xef0 0x5d 0x3a 0xeec 0x5d 0x3b 0xee8 0x5d 0x3c 0xee4 0x5d 0x3d 0xee1 0x5d 0x3e 0xedd 0x5d 0x3f 0xeda 0x5e 0x40 0xed6 0x5e 0x41 0xed3 0x5e 0x42 0xecf 0x5e 0x43 0xecb 0x5e 0x44 0xec6 0x5e 0x45 0xec1 0x5e 0x46 0xebd 0x5e 0x47 0xeb8 0x5e 0x48 0xeb3 0x5e 0x49 0xeae 0x5f 0x4a 0xeab 0x5f 0x4b 0xea9 0x5f 0x4c 0xea5 0x5f 0x4d 0xea3 0x5f 0x4e 0xea1 0x5f 0x4f 0xe9d 0x5f 0x50 0xe97 0x5f 0x51 0xe91 0x5f 0x52 0xe8b 0x60 0x53 0xe7e 0x5f 0x54 0xe75 0x60 0x55 0xe6f 0x60 0x56 0xe6e 0x60 0x57 0xe6d 0x60 0x58 0xe6c 0x60 0x59 0xe6a 0x60 0x5a 0xe68 0x60 0x5b 0xe60 0x60 0x5c 0xe52 0x60 0x5d 0xe43 0x60 0x5e 0xe16 0x61 0x5f 0xddc 0x60 0x60 0xd90 0x61 0x61 0xd7e 0x62 0x62 0xd6c 0x62 0x63 0xd59 0x64 0x64 0xd48 0x66>;
			vivo_battery0_profile_t3_num = <0x65>;
			vivo_battery0_profile_t4 = <0x0 0x1126 0x59 0x1 0x111c 0x59 0x2 0x110e 0x5a 0x3 0x10fd 0x5a 0x4 0x10f3 0x5b 0x5 0x10e8 0x5b 0x6 0x10dc 0x5c 0x7 0x10d0 0x5c 0x8 0x10c4 0x5d 0x9 0x10be 0x5d 0xa 0x10b8 0x5d 0xb 0x10ac 0x5d 0xc 0x10a0 0x5e 0xd 0x1093 0x5e 0xe 0x1087 0x5e 0xf 0x107b 0x5e 0x10 0x106e 0x5e 0x11 0x1062 0x5e 0x12 0x1056 0x5d 0x13 0x104a 0x5d 0x14 0x103e 0x5e 0x15 0x1032 0x5d 0x16 0x1027 0x5e 0x17 0x101b 0x5e 0x18 0x1010 0x5d 0x19 0x1005 0x5e 0x1a 0xff9 0x5e 0x1b 0xfef 0x5d 0x1c 0xfe4 0x5e 0x1d 0xfd9 0x5e 0x1e 0xfcf 0x5e 0x1f 0xfc5 0x5d 0x20 0xfbb 0x5e 0x21 0xfb1 0x5d 0x22 0xfa7 0x5d 0x23 0xfa2 0x5e 0x24 0xf9d 0x5d 0x25 0xf93 0x5d 0x26 0xf89 0x5d 0x27 0xf7c 0x5d 0x28 0xf6e 0x5d 0x29 0xf5f 0x5d 0x2a 0xf52 0x5c 0x2b 0xf48 0x5d 0x2c 0xf3f 0x5d 0x2d 0xf37 0x5d 0x2e 0xf2f 0x5d 0x2f 0xf28 0x5d 0x30 0xf22 0x5c 0x31 0xf1c 0x5d 0x32 0xf16 0x5c 0x33 0xf10 0x5d 0x34 0xf0b 0x5d 0x35 0xf06 0x5d 0x36 0xefc 0x5d 0x37 0xef3 0x5d 0x38 0xeee 0x5d 0x39 0xeea 0x5d 0x3a 0xee8 0x5e 0x3b 0xee6 0x5e 0x3c 0xee3 0x5e 0x3d 0xedf 0x5e 0x3e 0xedb 0x5f 0x3f 0xed8 0x5f 0x40 0xed4 0x5f 0x41 0xed1 0x5e 0x42 0xecd 0x5f 0x43 0xec8 0x5f 0x44 0xec3 0x5f 0x45 0xebe 0x5f 0x46 0xeb9 0x5f 0x47 0xeb4 0x5f 0x48 0xeaf 0x5f 0x49 0xeaa 0x5f 0x4a 0xea6 0x5f 0x4b 0xea2 0x5f 0x4c 0xe9e 0x5f 0x4d 0xe99 0x5f 0x4e 0xe93 0x5f 0x4f 0xe8c 0x5f 0x50 0xe87 0x5f 0x51 0xe80 0x5f 0x52 0xe78 0x5f 0x53 0xe70 0x5f 0x54 0xe6f 0x5f 0x55 0xe6e 0x5f 0x56 0xe6d 0x60 0x57 0xe6c 0x60 0x58 0xe6a 0x60 0x59 0xe69 0x60 0x5a 0xe64 0x60 0x5b 0xe5b 0x60 0x5c 0xe52 0x60 0x5d 0xe29 0x60 0x5e 0xdf5 0x60 0x5f 0xdb1 0x60 0x60 0xd89 0x62 0x61 0xd7a 0x62 0x62 0xd6b 0x62 0x63 0xd57 0x63 0x64 0xd48 0x66>;
			vivo_battery0_profile_t4_num = <0x65>;
			vivo_battery1_profile_t0 = <0x0 0x10c5 0x135 0x1 0x10b7 0x136 0x2 0x10a9 0x139 0x3 0x109c 0x13a 0x4 0x108e 0x13a 0x5 0x1081 0x13b 0x6 0x1074 0x13b 0x7 0x1067 0x13c 0x8 0x1061 0x13b 0x9 0x105b 0x13a 0xa 0x104e 0x13b 0xb 0x1042 0x139 0xc 0x1036 0x138 0xd 0x102a 0x138 0xe 0x101e 0x139 0xf 0x1012 0x138 0x10 0x1007 0x137 0x11 0x1002 0x138 0x12 0xffc 0x138 0x13 0xff2 0x136 0x14 0xfe7 0x136 0x15 0xfdb 0x136 0x16 0xfcf 0x136 0x17 0xfc2 0x136 0x18 0xfb6 0x136 0x19 0xfaa 0x136 0x1a 0xfa4 0x136 0x1b 0xf9e 0x136 0x1c 0xf93 0x136 0x1d 0xf88 0x137 0x1e 0xf7d 0x136 0x1f 0xf70 0x137 0x20 0xf63 0x138 0x21 0xf56 0x139 0x22 0xf4a 0x13a 0x23 0xf45 0x13c 0x24 0xf3f 0x13c 0x25 0xf35 0x13d 0x26 0xf2c 0x13f 0x27 0xf24 0x13f 0x28 0xf1d 0x141 0x29 0xf16 0x142 0x2a 0xf10 0x143 0x2b 0xf09 0x145 0x2c 0xf06 0x146 0x2d 0xf03 0x149 0x2e 0xefe 0x14a 0x2f 0xef8 0x14d 0x30 0xef3 0x14e 0x31 0xeee 0x14f 0x32 0xeea 0x151 0x33 0xee5 0x153 0x34 0xee1 0x156 0x35 0xedf 0x158 0x36 0xedd 0x15b 0x37 0xed9 0x15d 0x38 0xed5 0x160 0x39 0xed3 0x163 0x3a 0xed0 0x164 0x3b 0xece 0x166 0x3c 0xecd 0x16c 0x3d 0xecb 0x16e 0x3e 0xeca 0x171 0x3f 0xec9 0x175 0x40 0xec7 0x178 0x41 0xec5 0x17b 0x42 0xec3 0x17e 0x43 0xec0 0x17f 0x44 0xebd 0x181 0x45 0xeba 0x184 0x46 0xeb8 0x187 0x47 0xeb6 0x18b 0x48 0xeb1 0x18e 0x49 0xeac 0x192 0x4a 0xea7 0x196 0x4b 0xea0 0x198 0x4c 0xe99 0x199 0x4d 0xe93 0x19c 0x4e 0xe8c 0x1a3 0x4f 0xe88 0x1a7 0x50 0xe84 0x1ad 0x51 0xe7b 0x1b3 0x52 0xe73 0x1b7 0x53 0xe6d 0x1bc 0x54 0xe69 0x1bf 0x55 0xe65 0x1c3 0x56 0xe62 0x1c5 0x57 0xe5e 0x1c8 0x58 0xe5b 0x1cd 0x59 0xe58 0x1d4 0x5a 0xe4b 0x1d7 0x5b 0xe31 0x1df 0x5c 0xe1a 0x1e3 0x5d 0xe06 0x1e7 0x5e 0xded 0x1eb 0x5f 0xdd4 0x1f2 0x60 0xdb6 0x1f4 0x61 0xd98 0x1f8 0x62 0xd7a 0x1f4 0x63 0xd5c 0x203 0x64 0xd48 0x212>;
			vivo_battery1_profile_t0_num = <0x65>;
			vivo_battery1_profile_t1 = <0x0 0x10ef 0xb2 0x1 0x10e3 0xb3 0x2 0x10dd 0xb5 0x3 0x10d7 0xb5 0x4 0x10ca 0xb6 0x5 0x10bd 0xb6 0x6 0x10b1 0xb7 0x7 0x10a5 0xb7 0x8 0x1098 0xb7 0x9 0x108b 0xb5 0xa 0x107e 0xb5 0xb 0x1072 0xb2 0xc 0x1066 0xb4 0xd 0x105a 0xb5 0xe 0x1054 0xb4 0xf 0x104d 0xb4 0x10 0x1041 0xb4 0x11 0x1036 0xb4 0x12 0x102a 0xb3 0x13 0x101e 0xb3 0x14 0x1013 0xb3 0x15 0x1007 0xb4 0x16 0xffc 0xb3 0x17 0xff2 0xb4 0x18 0xfe8 0xb2 0x19 0xfdd 0xb2 0x1a 0xfd8 0xb3 0x1b 0xfd1 0xb3 0x1c 0xfc5 0xb3 0x1d 0xfba 0xb3 0x1e 0xfaf 0xb3 0x1f 0xfa4 0xb3 0x20 0xf99 0xb3 0x21 0xf8e 0xb4 0x22 0xf83 0xb4 0x23 0xf75 0xb5 0x24 0xf67 0xb5 0x25 0xf5a 0xb6 0x26 0xf54 0xb7 0x27 0xf4e 0xb6 0x28 0xf44 0xb8 0x29 0xf3b 0xb8 0x2a 0xf32 0xb8 0x2b 0xf2b 0xb9 0x2c 0xf24 0xb9 0x2d 0xf1d 0xba 0x2e 0xf17 0xba 0x2f 0xf11 0xbb 0x30 0xf0b 0xbc 0x31 0xf05 0xbd 0x32 0xf02 0xbe 0x33 0xf00 0xc0 0x34 0xefb 0xc1 0x35 0xef6 0xc2 0x36 0xef2 0xc1 0x37 0xeed 0xc1 0x38 0xee9 0xc3 0x39 0xee5 0xc4 0x3a 0xee1 0xc6 0x3b 0xedd 0xc7 0x3c 0xeda 0xc9 0x3d 0xed6 0xcb 0x3e 0xed4 0xcc 0x3f 0xed3 0xcf 0x40 0xed0 0xd1 0x41 0xecd 0xd5 0x42 0xecb 0xd7 0x43 0xec9 0xd8 0x44 0xec7 0xda 0x45 0xec5 0xdc 0x46 0xec3 0xdd 0x47 0xebf 0xde 0x48 0xebc 0xe0 0x49 0xeb7 0xe1 0x4a 0xeb5 0xe4 0x4b 0xeb3 0xe5 0x4c 0xeae 0xe6 0x4d 0xea9 0xe8 0x4e 0xea3 0xe9 0x4f 0xe9b 0xe9 0x50 0xe95 0xeb 0x51 0xe8e 0xed 0x52 0xe86 0xf0 0x53 0xe7d 0xf4 0x54 0xe75 0xf7 0x55 0xe71 0xf7 0x56 0xe70 0xfb 0x57 0xe6e 0xfd 0x58 0xe6b 0x100 0x59 0xe68 0x104 0x5a 0xe64 0x106 0x5b 0xe5b 0x108 0x5c 0xe44 0x10b 0x5d 0xe1b 0x110 0x5e 0xde1 0x115 0x5f 0xdca 0x11c 0x60 0xdb8 0x125 0x61 0xd9d 0x12e 0x62 0xd82 0x13a 0x63 0xd62 0x149 0x64 0xd48 0x156>;
			vivo_battery1_profile_t1_num = <0x65>;
			vivo_battery1_profile_t2 = <0x0 0x1127 0xa6 0x1 0x1117 0xa6 0x2 0x110a 0xa6 0x3 0x10ff 0xa6 0x4 0x10f3 0xa7 0x5 0x10e7 0xa6 0x6 0x10db 0xa6 0x7 0x10d5 0xa6 0x8 0x10ce 0xa6 0x9 0x10c2 0xa6 0xa 0x10b5 0xa5 0xb 0x10a9 0xa4 0xc 0x109c 0xa4 0xd 0x1090 0xa3 0xe 0x1083 0xa3 0xf 0x1077 0xa2 0x10 0x106a 0xa2 0x11 0x105e 0xa2 0x12 0x1052 0xa1 0x13 0x1046 0xa1 0x14 0x1040 0xa1 0x15 0x103a 0xa1 0x16 0x102e 0xa0 0x17 0x1023 0x9f 0x18 0x1017 0x9f 0x19 0x100c 0x9f 0x1a 0x1001 0x9f 0x1b 0xff5 0x9e 0x1c 0xfeb 0x9e 0x1d 0xfe1 0x9e 0x1e 0xfd6 0x9e 0x1f 0xfca 0x9e 0x20 0xfbf 0x9e 0x21 0xfba 0x9e 0x22 0xfb4 0x9e 0x23 0xfa9 0x9e 0x24 0xf9e 0x9e 0x25 0xf94 0x9e 0x26 0xf88 0x9f 0x27 0xf7b 0x9f 0x28 0xf6d 0x9f 0x29 0xf5f 0x9f 0x2a 0xf53 0xa0 0x2b 0xf48 0xa0 0x2c 0xf3e 0xa1 0x2d 0xf36 0xa0 0x2e 0xf32 0xa1 0x2f 0xf2e 0xa1 0x30 0xf27 0xa2 0x31 0xf20 0xa2 0x32 0xf19 0xa3 0x33 0xf13 0xa4 0x34 0xf0d 0xa4 0x35 0xf08 0xa4 0x36 0xf02 0xa5 0x37 0xefd 0xa6 0x38 0xef8 0xa7 0x39 0xef3 0xa8 0x3a 0xeee 0xa8 0x3b 0xeec 0xa9 0x3c 0xeea 0xaa 0x3d 0xee6 0xab 0x3e 0xee2 0xac 0x3f 0xede 0xad 0x40 0xeda 0xae 0x41 0xed7 0xaf 0x42 0xed4 0xb1 0x43 0xed0 0xb2 0x44 0xecd 0xb3 0x45 0xeca 0xb4 0x46 0xec8 0xb5 0x47 0xec5 0xb7 0x48 0xec4 0xb8 0x49 0xec3 0xb8 0x4a 0xec1 0xb9 0x4b 0xebe 0xbb 0x4c 0xeba 0xbc 0x4d 0xeb6 0xbd 0x4e 0xeb1 0xbd 0x4f 0xead 0xbf 0x50 0xea9 0xc0 0x51 0xea3 0xc2 0x52 0xe9d 0xc2 0x53 0xe96 0xc4 0x54 0xe8f 0xc6 0x55 0xe8c 0xc6 0x56 0xe89 0xc7 0x57 0xe80 0xc9 0x58 0xe77 0xca 0x59 0xe71 0xcd 0x5a 0xe6e 0xcf 0x5b 0xe6c 0xd1 0x5c 0xe69 0xd3 0x5d 0xe66 0xd5 0x5e 0xe62 0xd8 0x5f 0xe57 0xdc 0x60 0xe3b 0xe2 0x61 0xe0c 0xe7 0x62 0xded 0xeb 0x63 0xdcd 0xef 0x64 0xd48 0xfb>;
			vivo_battery1_profile_t2_num = <0x65>;
			vivo_battery1_profile_t3 = <0x0 0x1123 0x5e 0x1 0x1118 0x5e 0x2 0x110a 0x5e 0x3 0x10f9 0x5e 0x4 0x10ee 0x5e 0x5 0x10e3 0x5e 0x6 0x10d7 0x5f 0x7 0x10cb 0x5e 0x8 0x10c5 0x5e 0x9 0x10bf 0x5e 0xa 0x10b3 0x5f 0xb 0x10a6 0x5f 0xc 0x109a 0x5e 0xd 0x108e 0x5e 0xe 0x1081 0x5e 0xf 0x1075 0x5e 0x10 0x1069 0x5e 0x11 0x105d 0x5e 0x12 0x1051 0x5e 0x13 0x1045 0x5e 0x14 0x1039 0x5e 0x15 0x102d 0x5e 0x16 0x1021 0x5e 0x17 0x1016 0x5d 0x18 0x100a 0x5e 0x19 0xfff 0x5e 0x1a 0xff4 0x5e 0x1b 0xfe9 0x5d 0x1c 0xfdf 0x5e 0x1d 0xfd4 0x5d 0x1e 0xfca 0x5e 0x1f 0xfc5 0x5d 0x20 0xfc0 0x5d 0x21 0xfb6 0x5d 0x22 0xfac 0x5e 0x23 0xfa2 0x5e 0x24 0xf98 0x5e 0x25 0xf8e 0x5d 0x26 0xf83 0x5e 0x27 0xf76 0x5d 0x28 0xf67 0x5e 0x29 0xf59 0x5d 0x2a 0xf4d 0x5d 0x2b 0xf43 0x5d 0x2c 0xf3b 0x5d 0x2d 0xf33 0x5d 0x2e 0xf2c 0x5c 0x2f 0xf25 0x5d 0x30 0xf1f 0x5d 0x31 0xf19 0x5d 0x32 0xf13 0x5d 0x33 0xf0e 0x5d 0x34 0xf08 0x5d 0x35 0xf03 0x5d 0x36 0xefe 0x5d 0x37 0xef9 0x5d 0x38 0xef5 0x5d 0x39 0xef0 0x5d 0x3a 0xeec 0x5d 0x3b 0xee8 0x5d 0x3c 0xee4 0x5d 0x3d 0xee1 0x5d 0x3e 0xedd 0x5d 0x3f 0xeda 0x5e 0x40 0xed6 0x5e 0x41 0xed3 0x5e 0x42 0xecf 0x5e 0x43 0xecb 0x5e 0x44 0xec6 0x5e 0x45 0xec1 0x5e 0x46 0xebd 0x5e 0x47 0xeb8 0x5e 0x48 0xeb3 0x5e 0x49 0xeae 0x5f 0x4a 0xeab 0x5f 0x4b 0xea9 0x5f 0x4c 0xea5 0x5f 0x4d 0xea3 0x5f 0x4e 0xea1 0x5f 0x4f 0xe9d 0x5f 0x50 0xe97 0x5f 0x51 0xe91 0x5f 0x52 0xe8b 0x60 0x53 0xe7e 0x5f 0x54 0xe75 0x60 0x55 0xe6f 0x60 0x56 0xe6e 0x60 0x57 0xe6d 0x60 0x58 0xe6c 0x60 0x59 0xe6a 0x60 0x5a 0xe68 0x60 0x5b 0xe60 0x60 0x5c 0xe52 0x60 0x5d 0xe43 0x60 0x5e 0xe16 0x61 0x5f 0xddc 0x60 0x60 0xd90 0x61 0x61 0xd7e 0x62 0x62 0xd6c 0x62 0x63 0xd59 0x64 0x64 0xd48 0x66>;
			vivo_battery1_profile_t3_num = <0x65>;
			vivo_battery1_profile_t4 = <0x0 0x1124 0x59 0x1 0x111b 0x59 0x2 0x110e 0x5a 0x3 0x10fd 0x5a 0x4 0x10f3 0x5b 0x5 0x10e8 0x5b 0x6 0x10dc 0x5c 0x7 0x10d0 0x5c 0x8 0x10c4 0x5d 0x9 0x10be 0x5d 0xa 0x10b8 0x5d 0xb 0x10ac 0x5d 0xc 0x10a0 0x5e 0xd 0x1093 0x5e 0xe 0x1087 0x5e 0xf 0x107b 0x5e 0x10 0x106e 0x5e 0x11 0x1062 0x5e 0x12 0x1056 0x5d 0x13 0x104a 0x5d 0x14 0x103e 0x5e 0x15 0x1032 0x5d 0x16 0x1027 0x5e 0x17 0x101b 0x5e 0x18 0x1010 0x5d 0x19 0x1005 0x5e 0x1a 0xff9 0x5e 0x1b 0xfef 0x5d 0x1c 0xfe4 0x5e 0x1d 0xfd9 0x5e 0x1e 0xfcf 0x5e 0x1f 0xfc5 0x5d 0x20 0xfbb 0x5e 0x21 0xfb1 0x5d 0x22 0xfa7 0x5d 0x23 0xfa2 0x5e 0x24 0xf9d 0x5d 0x25 0xf93 0x5d 0x26 0xf89 0x5d 0x27 0xf7c 0x5d 0x28 0xf6e 0x5d 0x29 0xf5f 0x5d 0x2a 0xf52 0x5c 0x2b 0xf48 0x5d 0x2c 0xf3f 0x5d 0x2d 0xf37 0x5d 0x2e 0xf2f 0x5d 0x2f 0xf28 0x5d 0x30 0xf22 0x5c 0x31 0xf1c 0x5d 0x32 0xf16 0x5c 0x33 0xf10 0x5d 0x34 0xf0b 0x5d 0x35 0xf06 0x5d 0x36 0xefc 0x5d 0x37 0xef3 0x5d 0x38 0xeee 0x5d 0x39 0xeea 0x5d 0x3a 0xee8 0x5e 0x3b 0xee6 0x5e 0x3c 0xee3 0x5e 0x3d 0xedf 0x5e 0x3e 0xedb 0x5f 0x3f 0xed8 0x5f 0x40 0xed4 0x5f 0x41 0xed1 0x5e 0x42 0xecd 0x5f 0x43 0xec8 0x5f 0x44 0xec3 0x5f 0x45 0xebe 0x5f 0x46 0xeb9 0x5f 0x47 0xeb4 0x5f 0x48 0xeaf 0x5f 0x49 0xeaa 0x5f 0x4a 0xea6 0x5f 0x4b 0xea2 0x5f 0x4c 0xe9e 0x5f 0x4d 0xe99 0x5f 0x4e 0xe93 0x5f 0x4f 0xe8c 0x5f 0x50 0xe87 0x5f 0x51 0xe80 0x5f 0x52 0xe78 0x5f 0x53 0xe70 0x5f 0x54 0xe6f 0x5f 0x55 0xe6e 0x5f 0x56 0xe6d 0x60 0x57 0xe6c 0x60 0x58 0xe6a 0x60 0x59 0xe69 0x60 0x5a 0xe64 0x60 0x5b 0xe5b 0x60 0x5c 0xe52 0x60 0x5d 0xe29 0x60 0x5e 0xdf5 0x60 0x5f 0xdb1 0x60 0x60 0xd89 0x62 0x61 0xd7a 0x62 0x62 0xd6b 0x62 0x63 0xd57 0x63 0x64 0xd48 0x66>;
			vivo_battery1_profile_t4_num = <0x65>;
			vivo_battery2_profile_t0 = <0x0 0x1024 0x260 0x1 0x100e 0x26d 0x2 0xff4 0x268 0x3 0xfdf 0x263 0x4 0xfd2 0x25f 0x5 0xfc5 0x257 0x6 0xfbf 0x24b 0x7 0xfb9 0x249 0x8 0xfad 0x23f 0x9 0xfa1 0x23c 0xa 0xf97 0x239 0xb 0xf8c 0x22f 0xc 0xf87 0x22c 0xd 0xf82 0x224 0xe 0xf78 0x21f 0xf 0xf6e 0x21c 0x10 0xf63 0x218 0x11 0xf59 0x210 0x12 0xf53 0x209 0x13 0xf4e 0x201 0x14 0xf44 0x1f7 0x15 0xf3a 0x1f3 0x16 0xf31 0x1ee 0x17 0xf28 0x1e7 0x18 0xf24 0x1de 0x19 0xf20 0x1d5 0x1a 0xf18 0x1d3 0x1b 0xf12 0x1d0 0x1c 0xf0b 0x1ce 0x1d 0xf07 0x1cb 0x1e 0xf04 0x1c7 0x1f 0xefe 0x1c5 0x20 0xef9 0x1c4 0x21 0xef4 0x1c3 0x22 0xeef 0x1c1 0x23 0xeec 0x1c0 0x24 0xeea 0x1bf 0x25 0xee6 0x1bc 0x26 0xee2 0x1bb 0x27 0xede 0x1ba 0x28 0xedb 0x1b9 0x29 0xeda 0x1b8 0x2a 0xed9 0x1bb 0x2b 0xed6 0x1b9 0x2c 0xed4 0x1b6 0x2d 0xed1 0x1b7 0x2e 0xecf 0x1b8 0x2f 0xecd 0x1b6 0x30 0xecc 0x1b4 0x31 0xeca 0x1b2 0x32 0xec7 0x1b4 0x33 0xec4 0x1b5 0x34 0xec2 0x1b4 0x35 0xec0 0x1b4 0x36 0xebe 0x1b6 0x37 0xebb 0x1b6 0x38 0xeb8 0x1b8 0x39 0xeb4 0x1b9 0x3a 0xeb0 0x1bc 0x3b 0xeae 0x1bf 0x3c 0xeac 0x1bf 0x3d 0xea7 0x1c4 0x3e 0xea2 0x1c3 0x3f 0xe9d 0x1c2 0x40 0xe97 0x1c2 0x41 0xe93 0x1c6 0x42 0xe90 0x1c9 0x43 0xe8a 0x1cb 0x44 0xe82 0x1cc 0x45 0xe7a 0x1cc 0x46 0xe71 0x1ce 0x47 0xe6d 0x1d1 0x48 0xe68 0x1d3 0x49 0xe5f 0x1d4 0x4a 0xe55 0x1d4 0x4b 0xe4b 0x1d4 0x4c 0xe3f 0x1d8 0x4d 0xe39 0x1da 0x4e 0xe32 0x1df 0x4f 0xe28 0x1e2 0x50 0xe1c 0x1e4 0x51 0xe0f 0x1e5 0x52 0xdff 0x1e8 0x53 0xdf4 0x1ec 0x54 0xde6 0x1ee 0x55 0xdd6 0x1f2 0x56 0xdd0 0x1f4 0x57 0xdc8 0x1f5 0x58 0xdbb 0x1fa 0x59 0xdaf 0x1ff 0x5a 0xda7 0x203 0x5b 0xd9f 0x209 0x5c 0xd97 0x20a 0x5d 0xd8f 0x20c 0x5e 0xd84 0x211 0x5f 0xd78 0x213 0x60 0xd6c 0x21a 0x61 0xd64 0x219 0x62 0xd5c 0x21c 0x63 0xd52 0x21e 0x64 0xd48 0x223>;
			vivo_battery2_profile_t0_num = <0x65>;
			vivo_battery2_profile_t1 = <0x0 0x1025 0x168 0x1 0x1019 0x173 0x2 0x100e 0x176 0x3 0x1009 0x173 0x4 0x1003 0x172 0x5 0xff9 0x172 0x6 0xff0 0x16e 0x7 0xfe7 0x16d 0x8 0xfdb 0x16b 0x9 0xfd0 0x169 0xa 0xfc4 0x165 0xb 0xfb9 0x164 0xc 0xfb3 0x15f 0xd 0xfae 0x15d 0xe 0xfa3 0x15a 0xf 0xf9b 0x154 0x10 0xf90 0x154 0x11 0xf84 0x14e 0x12 0xf79 0x14c 0x13 0xf6e 0x148 0x14 0xf68 0x145 0x15 0xf62 0x140 0x16 0xf55 0x13c 0x17 0xf49 0x126 0x18 0xf3e 0x128 0x19 0xf34 0x123 0x1a 0xf2b 0x120 0x1b 0xf23 0x11d 0x1c 0xf1f 0x117 0x1d 0xf1c 0x114 0x1e 0xf15 0x114 0x1f 0xf0f 0x113 0x20 0xf09 0x10e 0x21 0xf00 0xef 0x22 0xefa 0x10c 0x23 0xef6 0x110 0x24 0xef4 0x10f 0x25 0xeec 0x10f 0x26 0xee2 0x10e 0x27 0xed1 0x10d 0x28 0xecf 0x10b 0x29 0xecc 0x109 0x2a 0xeca 0x109 0x2b 0xec9 0x106 0x2c 0xec6 0x107 0x2d 0xec3 0x109 0x2e 0xec1 0x109 0x2f 0xec0 0x108 0x30 0xebe 0x107 0x31 0xebb 0x108 0x32 0xeb7 0x106 0x33 0xeb3 0x105 0x34 0xeaf 0x107 0x35 0xeab 0x105 0x36 0xea8 0x109 0x37 0xea6 0x109 0x38 0xea0 0x108 0x39 0xe9b 0x109 0x3a 0xe94 0x10c 0x3b 0xe8e 0x10f 0x3c 0xe86 0x10e 0x3d 0xe7f 0x10c 0x3e 0xe77 0x10d 0x3f 0xe73 0x10f 0x40 0xe6f 0x110 0x41 0xe68 0x112 0x42 0xe61 0x113 0x43 0xe5a 0x116 0x44 0xe51 0x117 0x45 0xe4d 0x108 0x46 0xe4a 0x116 0x47 0xe47 0x116 0x48 0xe44 0x116 0x49 0xe40 0x113 0x4a 0xe3b 0x11e 0x4b 0xe38 0x120 0x4c 0xe34 0x123 0x4d 0xe2f 0x125 0x4e 0xe2b 0x127 0x4f 0xe26 0x127 0x50 0xe1f 0x129 0x51 0xe12 0x12b 0x52 0xe06 0x129 0x53 0xdfa 0x12e 0x54 0xdee 0x130 0x55 0xde2 0x132 0x56 0xdd6 0x136 0x57 0xdca 0x13a 0x58 0xdc0 0x13a 0x59 0xdbb 0x13c 0x5a 0xdb1 0x13e 0x5b 0xe0b 0x142 0x5c 0xd9d 0x148 0x5d 0xd96 0x14d 0x5e 0xd8a 0x153 0x5f 0xd80 0x157 0x60 0xd74 0x15e 0x61 0xd68 0x15e 0x62 0xd5b 0x15f 0x63 0xd53 0x161 0x64 0xd48 0x163>;
			vivo_battery2_profile_t1_num = <0x65>;
			vivo_battery2_profile_t2 = <0x0 0x10f7 0xeb 0x1 0x10eb 0xf2 0x2 0x10de 0xf0 0x3 0x10d1 0xf0 0x4 0x10cb 0xef 0x5 0x10c5 0xee 0x6 0x10b8 0xec 0x7 0x10ab 0xeb 0x8 0x109f 0xeb 0x9 0x1093 0xe8 0xa 0x1086 0xe5 0xb 0x107a 0xe2 0xc 0x106d 0xe1 0xd 0x1061 0xdd 0xe 0x1055 0xdc 0xf 0x1049 0xd8 0x10 0x103e 0xd6 0x11 0x1032 0xd4 0x12 0x102c 0xd1 0x13 0x1026 0xd0 0x14 0x101b 0xcd 0x15 0x1010 0xcd 0x16 0x1004 0xcc 0x17 0xffa 0xc8 0x18 0xff0 0xc5 0x19 0xfe7 0xc4 0x1a 0xfdc 0xc1 0x1b 0xfd1 0xbe 0x1c 0xfc6 0xb9 0x1d 0xfbb 0xb6 0x1e 0xfb1 0xb6 0x1f 0xfa6 0xb4 0x20 0xfa1 0xb2 0x21 0xf9c 0xb3 0x22 0xf92 0xb0 0x23 0xf86 0xb0 0x24 0xf79 0xaf 0x25 0xf6c 0xaf 0x26 0xf5f 0xaf 0x27 0xf52 0xae 0x28 0xf48 0xae 0x29 0xf3e 0xab 0x2a 0xf36 0xab 0x2b 0xf2e 0xab 0x2c 0xf27 0xab 0x2d 0xf20 0xab 0x2e 0xf1d 0xac 0x2f 0xf1a 0xab 0x30 0xf13 0xab 0x31 0xf0e 0xab 0x32 0xf08 0xab 0x33 0xf02 0xab 0x34 0xefe 0xac 0x35 0xef8 0xad 0x36 0xef4 0xad 0x37 0xeef 0xad 0x38 0xeeb 0xae 0x39 0xee7 0xb0 0x3a 0xee2 0xaf 0x3b 0xedf 0xb2 0x3c 0xedd 0xb2 0x3d 0xedb 0xb2 0x3e 0xed8 0xb3 0x3f 0xed4 0xb4 0x40 0xed1 0xb4 0x41 0xecd 0xb6 0x42 0xecb 0xb6 0x43 0xec8 0xb8 0x44 0xec5 0xb8 0x45 0xec3 0xbb 0x46 0xec0 0xba 0x47 0xebd 0xba 0x48 0xeb9 0xbd 0x49 0xeb5 0xc0 0x4a 0xeb3 0xc0 0x4b 0xeb1 0xc1 0x4c 0xead 0xc3 0x4d 0xea9 0xc3 0x4e 0xea5 0xc2 0x4f 0xea0 0xc3 0x50 0xe9a 0xc5 0x51 0xe94 0xc5 0x52 0xe8e 0xc8 0x53 0xe88 0xc8 0x54 0xe80 0xca 0x55 0xe78 0xca 0x56 0xe72 0xcd 0x57 0xe6e 0xcd 0x58 0xe6c 0xcf 0x59 0xe6a 0xd2 0x5a 0xe68 0xd4 0x5b 0xe64 0xd5 0x5c 0xe5e 0xd6 0x5d 0xe53 0xd8 0x5e 0xe3c 0xda 0x5f 0xe22 0xdd 0x60 0xe04 0xe2 0x61 0xde0 0xe8 0x62 0xdb8 0xef 0x63 0xd86 0xf8 0x64 0xd48 0x101>;
			vivo_battery2_profile_t2_num = <0x65>;
			vivo_battery2_profile_t3 = <0x0 0x10f9 0x6c 0x1 0x10ed 0x68 0x2 0x10e2 0x67 0x3 0x10d6 0x6a 0x4 0x10c9 0x6d 0x5 0x10bd 0x6a 0x6 0x10b1 0x6a 0x7 0x10a4 0x6d 0x8 0x1098 0x6a 0x9 0x108b 0x6d 0xa 0x107f 0x6c 0xb 0x1079 0x6d 0xc 0x1073 0x6a 0xd 0x1066 0x6d 0xe 0x105a 0x67 0xf 0x104e 0x6d 0x10 0x1042 0x6c 0x11 0x1037 0x6b 0x12 0x102a 0x6a 0x13 0x101f 0x6c 0x14 0x1014 0x6c 0x15 0x1009 0x6a 0x16 0xffe 0x6a 0x17 0xff3 0x69 0x18 0xfea 0x6b 0x19 0xfe0 0x67 0x1a 0xfd6 0x6b 0x1b 0xfcb 0x6a 0x1c 0xfc1 0x6c 0x1d 0xfb7 0x6a 0x1e 0xfac 0x6a 0x1f 0xfa2 0x6d 0x20 0xf98 0x68 0x21 0xf8f 0x6c 0x22 0xf86 0x6d 0x23 0xf7c 0x69 0x24 0xf71 0x67 0x25 0xf64 0x6b 0x26 0xf56 0x6a 0x27 0xf49 0x6a 0x28 0xf3e 0x6b 0x29 0xf36 0x6b 0x2a 0xf2e 0x6a 0x2b 0xf2b 0x69 0x2c 0xf27 0x67 0x2d 0xf20 0x6c 0x2e 0xf1a 0x6d 0x2f 0xf14 0x6b 0x30 0xf0e 0x6b 0x31 0xf09 0x6b 0x32 0xf03 0x6c 0x33 0xefe 0x6b 0x34 0xefa 0x6c 0x35 0xef5 0x6b 0x36 0xef0 0x68 0x37 0xeec 0x6a 0x38 0xee8 0x6c 0x39 0xee4 0x68 0x3a 0xee0 0x6b 0x3b 0xedd 0x67 0x3c 0xed9 0x6c 0x3d 0xed6 0x6c 0x3e 0xed3 0x68 0x3f 0xed0 0x6c 0x40 0xecd 0x6d 0x41 0xec9 0x6d 0x42 0xec6 0x68 0x43 0xec1 0x6c 0x44 0xebd 0x6d 0x45 0xeb9 0x6d 0x46 0xeb4 0x6d 0x47 0xeb0 0x6d 0x48 0xeab 0x69 0x49 0xea7 0x68 0x4a 0xea4 0x6c 0x4b 0xea2 0x69 0x4c 0xea0 0x6d 0x4d 0xe9c 0x6c 0x4e 0xe98 0x6a 0x4f 0xe92 0x6d 0x50 0xe88 0x6c 0x51 0xe80 0x6c 0x52 0xe78 0x6c 0x53 0xe6f 0x6a 0x54 0xe6d 0x6a 0x55 0xe6a 0x6c 0x56 0xe68 0x6b 0x57 0xe66 0x69 0x58 0xe60 0x6d 0x59 0xe50 0x6b 0x5a 0xe28 0x6b 0x5b 0xe10 0x6a 0x5c 0xdf1 0x6c 0x5d 0xdca 0x6c 0x5e 0xdb6 0x6b 0x5f 0xda2 0x6b 0x60 0xd8e 0x6b 0x61 0xd7a 0x6c 0x62 0xd66 0x6c 0x63 0xd52 0x6d 0x64 0xd48 0x70>;
			vivo_battery2_profile_t3_num = <0x65>;
			vivo_battery2_profile_t4 = <0x0 0x10ff 0x64 0x1 0x10f4 0x64 0x2 0x10e8 0x62 0x3 0x10dc 0x64 0x4 0x10d0 0x63 0x5 0x10c5 0x64 0x6 0x10b8 0x64 0x7 0x10ac 0x63 0x8 0x109f 0x63 0x9 0x1093 0x62 0xa 0x1087 0x63 0xb 0x107a 0x64 0xc 0x106e 0x62 0xd 0x1068 0x63 0xe 0x1062 0x62 0xf 0x1055 0x63 0x10 0x1049 0x61 0x11 0x103d 0x63 0x12 0x1032 0x63 0x13 0x1026 0x63 0x14 0x101b 0x60 0x15 0x100f 0x63 0x16 0x1004 0x62 0x17 0xff9 0x60 0x18 0xfef 0x60 0x19 0xfe5 0x60 0x1a 0xfdb 0x62 0x1b 0xfd1 0x60 0x1c 0xfc7 0x62 0x1d 0xfbd 0x5f 0x1e 0xfb3 0x63 0x1f 0xfa9 0x62 0x20 0xfa0 0x60 0x21 0xf97 0x61 0x22 0xf8e 0x62 0x23 0xf85 0x61 0x24 0xf7b 0x62 0x25 0xf71 0x61 0x26 0xf63 0x60 0x27 0xf54 0x5f 0x28 0xf47 0x62 0x29 0xf3d 0x61 0x2a 0xf34 0x62 0x2b 0xf2d 0x61 0x2c 0xf26 0x62 0x2d 0xf20 0x62 0x2e 0xf19 0x60 0x2f 0xf13 0x61 0x30 0xf0d 0x5f 0x31 0xf0b 0x61 0x32 0xf08 0x62 0x33 0xf03 0x60 0x34 0xefe 0x62 0x35 0xef8 0x61 0x36 0xef4 0x61 0x37 0xeef 0x62 0x38 0xeeb 0x61 0x39 0xee7 0x62 0x3a 0xee3 0x60 0x3b 0xedf 0x62 0x3c 0xedb 0x62 0x3d 0xed8 0x62 0x3e 0xed4 0x60 0x3f 0xed1 0x61 0x40 0xece 0x63 0x41 0xeca 0x62 0x42 0xec6 0x61 0x43 0xebf 0x62 0x44 0xeb7 0x4f 0x45 0xeb0 0x4f 0x46 0xeab 0x4d 0x47 0xea6 0x4f 0x48 0xea1 0x4f 0x49 0xe9d 0x4f 0x4a 0xe98 0x63 0x4b 0xe94 0x63 0x4c 0xe90 0x63 0x4d 0xe8c 0x63 0x4e 0xe88 0x63 0x4f 0xe81 0x4f 0x50 0xe7b 0x4d 0x51 0xe6c 0x4d 0x52 0xe66 0x4e 0x53 0xe62 0x4f 0x54 0xe61 0x4f 0x55 0xe5f 0x60 0x56 0xe5e 0x64 0x57 0xe5d 0x63 0x58 0xe5b 0x63 0x59 0xe58 0x63 0x5a 0xe50 0x59 0x5b 0xe31 0x4f 0x5c 0xe11 0x50 0x5d 0xe03 0x4f 0x5e 0xdc7 0x4e 0x5f 0xdb4 0x50 0x60 0xda0 0x4f 0x61 0xd8c 0x50 0x62 0xd78 0x4d 0x63 0xd62 0x51 0x64 0xd48 0x50>;
			vivo_battery2_profile_t4_num = <0x65>;
			vivo_battery3_profile_t0 = <0x0 0x112f 0x189 0x1 0x111c 0x186 0x2 0x110d 0x181 0x3 0x1100 0x17d 0x4 0x10f3 0x178 0x5 0x10e6 0x173 0x6 0x10e0 0x171 0x7 0x10da 0x16f 0x8 0x10ce 0x16c 0x9 0x10c1 0x168 0xa 0x10b5 0x166 0xb 0x10a9 0x161 0xc 0x109d 0x15e 0xd 0x1090 0x15b 0xe 0x1084 0x157 0xf 0x1078 0x154 0x10 0x106c 0x152 0x11 0x1066 0x151 0x12 0x1060 0x150 0x13 0x1055 0x14d 0x14 0x1049 0x14c 0x15 0x103d 0x149 0x16 0x1032 0x146 0x17 0x1026 0x143 0x18 0x101b 0x143 0x19 0x100f 0x141 0x1a 0x1005 0x139 0x1b 0xffb 0x140 0x1c 0xff5 0x13f 0x1d 0xff0 0x13e 0x1e 0xfe5 0x13d 0x1f 0xfd9 0x13c 0x20 0xfcd 0x13a 0x21 0xfc1 0x139 0x22 0xfb5 0x138 0x23 0xfa9 0x138 0x24 0xf9d 0x138 0x25 0xf91 0x139 0x26 0xf85 0x13a 0x27 0xf7f 0x13a 0x28 0xf7a 0x13b 0x29 0xf6f 0x13b 0x2a 0xf63 0x13c 0x2b 0xf58 0x13e 0x2c 0xf4d 0x13f 0x2d 0xf43 0x13f 0x2e 0xf3a 0x140 0x2f 0xf32 0x143 0x30 0xf2a 0x143 0x31 0xf23 0x145 0x32 0xf1f 0x146 0x33 0xf1c 0x147 0x34 0xf15 0x147 0x35 0xf0f 0x148 0x36 0xf0a 0x14c 0x37 0xf04 0x14e 0x38 0xeff 0x150 0x39 0xefa 0x152 0x3a 0xef5 0x154 0x3b 0xef0 0x156 0x3c 0xeec 0x159 0x3d 0xee9 0x15a 0x3e 0xee7 0x15c 0x3f 0xee3 0x15d 0x40 0xedf 0x161 0x41 0xedc 0x163 0x42 0xed9 0x167 0x43 0xed6 0x16a 0x44 0xed4 0x16d 0x45 0xed1 0x16e 0x46 0xed0 0x171 0x47 0xece 0x174 0x48 0xecd 0x175 0x49 0xecc 0x177 0x4a 0xec9 0x178 0x4b 0xec7 0x17c 0x4c 0xec5 0x16c 0x4d 0xec2 0x185 0x4e 0xebf 0x188 0x4f 0xebb 0x18c 0x50 0xeb7 0x18f 0x51 0xeb2 0x195 0x52 0xead 0x199 0x53 0xea9 0x19b 0x54 0xea6 0x19e 0x55 0xe9f 0x1a5 0x56 0xe98 0x1ab 0x57 0xe91 0x1b1 0x58 0xe89 0x1b6 0x59 0xe81 0x1bd 0x5a 0xe77 0x1c5 0x5b 0xe70 0x1cd 0x5c 0xe6b 0x1d5 0x5d 0xe67 0x1df 0x5e 0xe65 0x1e3 0x5f 0xe63 0x1e8 0x60 0xe60 0x1f4 0x61 0xe1a 0x200 0x62 0xdd4 0x210 0x63 0xd8e 0x223 0x64 0xd48 0x233>;
			vivo_battery3_profile_t0_num = <0x65>;
			vivo_battery3_profile_t1 = <0x0 0x1128 0xae 0x1 0x1117 0xae 0x2 0x1109 0xae 0x3 0x10fd 0xaf 0x4 0x10f1 0xaf 0x5 0x10e5 0xaf 0x6 0x10da 0xaf 0x7 0x10d4 0xaf 0x8 0x10ce 0xaf 0x9 0x10c1 0xaf 0xa 0x10b5 0xae 0xb 0x10a9 0xae 0xc 0x109c 0xae 0xd 0x1090 0xac 0xe 0x1084 0xad 0xf 0x1077 0xac 0x10 0x106b 0xac 0x11 0x105f 0xac 0x12 0x1053 0xac 0x13 0x1047 0xab 0x14 0x1041 0xab 0x15 0x103c 0xab 0x16 0x1030 0xab 0x17 0x1025 0xab 0x18 0x1019 0xab 0x19 0x100e 0xab 0x1a 0x1003 0xab 0x1b 0xff8 0xab 0x1c 0xfee 0xac 0x1d 0xfe4 0xac 0x1e 0xfd9 0xab 0x1f 0xfce 0xab 0x20 0xfc3 0xab 0x21 0xfbd 0xac 0x22 0xfb8 0xac 0x23 0xfae 0xac 0x24 0xfa4 0xac 0x25 0xf99 0xad 0x26 0xf90 0xae 0x27 0xf85 0xae 0x28 0xf78 0xaf 0x29 0xf6a 0xaf 0x2a 0xf5b 0xaf 0x2b 0xf4f 0xb0 0x2c 0xf45 0xb2 0x2d 0xf3b 0xb2 0x2e 0xf37 0xb2 0x2f 0xf33 0xb2 0x30 0xf2c 0xb3 0x31 0xf25 0xb4 0x32 0xf1e 0xb5 0x33 0xf18 0xb6 0x34 0xf12 0xb6 0x35 0xf0d 0xb8 0x36 0xf07 0xb9 0x37 0xf02 0xba 0x38 0xefd 0xba 0x39 0xef8 0xbc 0x3a 0xef4 0xbe 0x3b 0xeef 0xbe 0x3c 0xeed 0xbf 0x3d 0xeeb 0xc0 0x3e 0xee7 0xc2 0x3f 0xee3 0xc3 0x40 0xedf 0xc4 0x41 0xedc 0xc6 0x42 0xed8 0xc7 0x43 0xed5 0xc9 0x44 0xed2 0xcb 0x45 0xecf 0xcc 0x46 0xecd 0xce 0x47 0xeca 0xcf 0x48 0xec8 0xd1 0x49 0xec7 0xd2 0x4a 0xec6 0xd2 0x4b 0xec3 0xd3 0x4c 0xec0 0xd4 0x4d 0xebc 0xd6 0x4e 0xeb7 0xd7 0x4f 0xeb2 0xd8 0x50 0xeae 0xd9 0x51 0xea9 0xdb 0x52 0xea3 0xde 0x53 0xe9b 0xe0 0x54 0xe94 0xe1 0x55 0xe8e 0xe3 0x56 0xe8a 0xe5 0x57 0xe86 0xe6 0x58 0xe7c 0xe9 0x59 0xe74 0xea 0x5a 0xe70 0xed 0x5b 0xe6d 0xef 0x5c 0xe6a 0xf4 0x5d 0xe67 0xf9 0x5e 0xe63 0xfe 0x5f 0xe5b 0x105 0x60 0xe43 0x10d 0x61 0xe14 0x117 0x62 0xdd6 0x123 0x63 0xd8e 0x12c 0x64 0xd48 0x135>;
			vivo_battery3_profile_t1_num = <0x65>;
			vivo_battery3_profile_t2 = <0x0 0x1134 0x75 0x1 0x1126 0x73 0x2 0x111a 0x74 0x3 0x1110 0x74 0x4 0x1105 0x74 0x5 0x10fa 0x74 0x6 0x10ee 0x73 0x7 0x10e3 0x74 0x8 0x10d8 0x73 0x9 0x10d2 0x73 0xa 0x10cc 0x73 0xb 0x10c0 0x73 0xc 0x10b3 0x74 0xd 0x10a7 0x72 0xe 0x109b 0x73 0xf 0x108f 0x73 0x10 0x1083 0x72 0x11 0x1076 0x72 0x12 0x106a 0x72 0x13 0x105e 0x72 0x14 0x1052 0x71 0x15 0x1047 0x71 0x16 0x103b 0x72 0x17 0x102f 0x71 0x18 0x1024 0x71 0x19 0x1019 0x70 0x1a 0x100e 0x71 0x1b 0x1008 0x71 0x1c 0x1002 0x70 0x1d 0xff8 0x71 0x1e 0xfed 0x71 0x1f 0xfe3 0x71 0x20 0xfd9 0x72 0x21 0xfcf 0x71 0x22 0xfc4 0x72 0x23 0xfba 0x72 0x24 0xfb0 0x71 0x25 0xfa6 0x72 0x26 0xf9c 0x71 0x27 0xf93 0x71 0x28 0xf88 0x72 0x29 0xf7c 0x72 0x2a 0xf6d 0x71 0x2b 0xf5f 0x73 0x2c 0xf52 0x72 0x2d 0xf4d 0x72 0x2e 0xf48 0x73 0x2f 0xf3f 0x74 0x30 0xf36 0x73 0x31 0xf30 0x73 0x32 0xf29 0x74 0x33 0xf22 0x74 0x34 0xf1c 0x74 0x35 0xf16 0x75 0x36 0xf11 0x76 0x37 0xf0b 0x76 0x38 0xf06 0x77 0x39 0xf01 0x76 0x3a 0xefc 0x77 0x3b 0xef8 0x78 0x3c 0xef3 0x77 0x3d 0xeef 0x78 0x3e 0xeeb 0x79 0x3f 0xee9 0x79 0x40 0xee7 0x7a 0x41 0xee3 0x7a 0x42 0xedf 0x79 0x43 0xedc 0x7b 0x44 0xed9 0x7c 0x45 0xed6 0x7b 0x46 0xed3 0x7d 0x47 0xed0 0x7d 0x48 0xecc 0x7e 0x49 0xec9 0x7f 0x4a 0xec5 0x7e 0x4b 0xec1 0x80 0x4c 0xebc 0x7f 0x4d 0xeb7 0x80 0x4e 0xeb2 0x82 0x4f 0xeae 0x80 0x50 0xeab 0x82 0x51 0xea8 0x82 0x52 0xea6 0x83 0x53 0xea0 0x82 0x54 0xe99 0x81 0x55 0xe93 0x83 0x56 0xe8e 0x84 0x57 0xe86 0x84 0x58 0xe7d 0x85 0x59 0xe76 0x85 0x5a 0xe74 0x85 0x5b 0xe72 0x86 0x5c 0xe70 0x87 0x5d 0xe6e 0x88 0x5e 0xe6b 0x88 0x5f 0xe63 0x8b 0x60 0xe47 0x8b 0x61 0xe17 0x8c 0x62 0xdd9 0x8f 0x63 0xd8e 0x91 0x64 0xd48 0x92>;
			vivo_battery3_profile_t2_num = <0x65>;
			vivo_battery3_profile_t3 = <0x0 0x113c 0x55 0x1 0x112f 0x55 0x2 0x1124 0x55 0x3 0x111a 0x55 0x4 0x1110 0x56 0x5 0x1105 0x55 0x6 0x10fa 0x55 0x7 0x10ef 0x55 0x8 0x10e4 0x55 0x9 0x10d8 0x55 0xa 0x10cd 0x55 0xb 0x10c1 0x55 0xc 0x10b4 0x54 0xd 0x1086 0x55 0xe 0x10a9 0x55 0xf 0x109d 0x55 0x10 0x1090 0x55 0x11 0x1084 0x54 0x12 0x1078 0x55 0x13 0x106c 0x55 0x14 0x1060 0x54 0x15 0x1054 0x54 0x16 0x1049 0x55 0x17 0x103d 0x54 0x18 0x1031 0x54 0x19 0x1026 0x54 0x1a 0x101b 0x54 0x1b 0x100f 0x53 0x1c 0x1005 0x55 0x1d 0xffa 0x54 0x1e 0xfef 0x54 0x1f 0xfe5 0x54 0x20 0xfda 0x54 0x21 0xfd1 0x54 0x22 0xfc7 0x54 0x23 0xfbd 0x54 0x24 0xfb3 0x53 0x25 0xfa9 0x54 0x26 0xfa4 0x53 0x27 0xfa0 0x53 0x28 0xf97 0x54 0x29 0xf8d 0x54 0x2a 0xf82 0x54 0x2b 0xf76 0x55 0x2c 0xf68 0x55 0x2d 0xf59 0x53 0x2e 0xf4d 0x54 0x2f 0xf43 0x53 0x30 0xf3b 0x54 0x31 0xf34 0x54 0x32 0xf2d 0x54 0x33 0xf27 0x54 0x34 0xf21 0x54 0x35 0xf1b 0x54 0x36 0xf15 0x53 0x37 0xf10 0x54 0x38 0xf0b 0x54 0x39 0xf06 0x53 0x3a 0xf01 0x54 0x3b 0xefc 0x53 0x3c 0xef8 0x55 0x3d 0xef4 0x54 0x3e 0xeef 0x54 0x3f 0xeec 0x54 0x40 0xeea 0x54 0x41 0xee8 0x54 0x42 0xee5 0x55 0x43 0xee1 0x55 0x44 0xedd 0x54 0x45 0xeda 0x54 0x46 0xed7 0x54 0x47 0xed3 0x54 0x48 0xecf 0x55 0x49 0xeca 0x56 0x4a 0xec4 0x54 0x4b 0xec0 0x55 0x4c 0xebb 0x56 0x4d 0xeb6 0x55 0x4e 0xeb1 0x55 0x4f 0xeac 0x56 0x50 0xea8 0x55 0x51 0xea4 0x57 0x52 0xe9f 0x56 0x53 0xe99 0x56 0x54 0xe93 0x58 0x55 0xe8d 0x57 0x56 0xe86 0x56 0x57 0xe7f 0x57 0x58 0xe76 0x56 0x59 0xe10 0x56 0x5a 0xe73 0x57 0x5b 0xe71 0x57 0x5c 0xe70 0x56 0x5d 0xe6f 0x57 0x5e 0xe6d 0x58 0x5f 0xe68 0x57 0x60 0xe58 0x58 0x61 0xe30 0x57 0x62 0xdfb 0x58 0x63 0xda4 0x59 0x64 0xd48 0x5b>;
			vivo_battery3_profile_t3_num = <0x65>;
			vivo_battery3_profile_t4 = <0x0 0x1140 0x4b 0x1 0x1132 0x4b 0x2 0x1126 0x4b 0x3 0x111a 0x4b 0x4 0x110f 0x4a 0x5 0x1104 0x4a 0x6 0x10f9 0x4b 0x7 0x10ee 0x4a 0x8 0x10e3 0x4b 0x9 0x10d7 0x4b 0xa 0x10cb 0x4b 0xb 0x10c0 0x4b 0xc 0x10ba 0x4b 0xd 0x10b4 0x4b 0xe 0x10a8 0x4b 0xf 0x109c 0x4b 0x10 0x1090 0x4a 0x11 0x1084 0x4b 0x12 0x1077 0x4b 0x13 0x106c 0x4b 0x14 0x105f 0x4b 0x15 0x1054 0x4c 0x16 0x1048 0x4b 0x17 0x103c 0x4b 0x18 0x1031 0x4c 0x19 0x1025 0x4b 0x1a 0x101a 0x4a 0x1b 0x100f 0x4c 0x1c 0x1004 0x4c 0x1d 0xff9 0x4c 0x1e 0xfef 0x4c 0x1f 0xfe5 0x4c 0x20 0xfda 0x4b 0x21 0xfd0 0x4c 0x22 0xfc6 0x4c 0x23 0xfc1 0x4b 0x24 0xfbc 0x4a 0x25 0xfb3 0x4b 0x26 0xfaa 0x4c 0x27 0xfa0 0x4b 0x28 0xf98 0x4c 0x29 0xf8e 0x4c 0x2a 0xf84 0x4b 0x2b 0xf79 0x4c 0x2c 0xf6a 0x4c 0x2d 0xf5b 0x4c 0x2e 0xf4f 0x4b 0x2f 0xf46 0x4b 0x30 0xf3e 0x4a 0x31 0xf36 0x4a 0x32 0xf30 0x4b 0x33 0xf29 0x4b 0x34 0xf23 0x4b 0x35 0xf1d 0x4b 0x36 0xf17 0x4b 0x37 0xf12 0x4b 0x38 0xf0c 0x4b 0x39 0xf07 0x4a 0x3a 0xf04 0x4a 0x3b 0xf02 0x4b 0x3c 0xefd 0x4b 0x3d 0xef9 0x4b 0x3e 0xef4 0x4b 0x3f 0xef0 0x4b 0x40 0xeec 0x4b 0x41 0xee8 0x4a 0x42 0xee5 0x4b 0x43 0xee1 0x4b 0x44 0xedd 0x4b 0x45 0xed9 0x4b 0x46 0xed5 0x4b 0x47 0xed0 0x4b 0x48 0xec8 0x4b 0x49 0xebf 0x4c 0x4a 0xeb9 0x4b 0x4b 0xeb3 0x4b 0x4c 0xeae 0x4c 0x4d 0xea9 0x4a 0x4e 0xea4 0x4c 0x4f 0xe9f 0x4c 0x50 0xe9b 0x4c 0x51 0xe98 0x4c 0x52 0xe96 0x4c 0x53 0xe91 0x4b 0x54 0xe8b 0x4c 0x55 0xe84 0x4d 0x56 0xe7d 0x4c 0x57 0xe77 0x4d 0x58 0xe6f 0x4d 0x59 0xe67 0x4d 0x5a 0xe65 0x4d 0x5b 0xe64 0x4d 0x5c 0xe63 0x4d 0x5d 0xe61 0x4e 0x5e 0xe5f 0x4d 0x5f 0xe58 0x4e 0x60 0xe3d 0x4e 0x61 0xe12 0x4f 0x62 0xddb 0x50 0x63 0xd92 0x50 0x64 0xd48 0x52>;
			vivo_battery3_profile_t4_num = <0x65>;
			vivo_battery4_profile_t0;
			vivo_battery4_profile_t0_num = <0x65>;
			vivo_battery4_profile_t1;
			vivo_battery4_profile_t1_num = <0x65>;
			vivo_battery4_profile_t2;
			vivo_battery4_profile_t2_num = <0x65>;
			vivo_battery4_profile_t3;
			vivo_battery4_profile_t3_num = <0x65>;
			vivo_battery4_profile_t4;
			vivo_battery4_profile_t4_num = <0x65>;
		};
	};

	fragment@57 {
		target = <0xffffffff>;

		__overlay__ {
			compatible = "vivo,charger-monitor-v2";
			status = "okay";

			single_charger_board {
				phandle = <0x75>;
				support-board-version = "xxxxxx";
				vivo,5v-parallel-fboff-tc-data = <0xffffdd48 0x22b8 0x0>;
				vivo,5v-parallel-fboff-tc-row-col = <0x1 0x3>;
				vivo,5v-parallel-fbon-tc-data = <0xffffdd48 0x22b8 0x0>;
				vivo,5v-parallel-fbon-tc-row-col = <0x1 0x3>;
				vivo,5v-primary-fboff-tc-data = <0x1eb 0x22b8 0x200 0x1d7 0x1ea 0x400 0x1c3 0x1d6 0x4c0 0x1af 0x1c2 0x640 0x19b 0x1ae 0x708 0xffffdd48 0x19a 0x900>;
				vivo,5v-primary-fboff-tc-row-col = <0x6 0x3>;
				vivo,5v-primary-fbon-tc-data = <0x1eb 0x22b8 0x200 0x1d7 0x1ea 0x400 0x1c3 0x1d6 0x4c0 0x1af 0x1c2 0x580 0x19b 0x1ae 0x640 0x17d 0x19a 0x708 0xffffdd48 0x17c 0x800>;
				vivo,5v-primary-fbon-tc-row-col = <0x7 0x3>;
				vivo,9v-2nd-parallel-fboff-tc-data = <0x1af 0x22b8 0x1f4 0x19b 0x1ae 0x2bc 0x17d 0x19a 0x316 0x173 0x17c 0x41a 0x15f 0x172 0x514 0xffffdd48 0x15e 0x5dc>;
				vivo,9v-2nd-parallel-fboff-tc-row-col = <0x6 0x3>;
				vivo,9v-2nd-parallel-fbon-tc-data = <0x191 0x22b8 0x200 0x182 0x190 0x320 0xffffdd48 0x181 0x3e8>;
				vivo,9v-2nd-parallel-fbon-tc-row-col = <0x3 0x3>;
				vivo,9v-parallel-fboff-tc-data = <0x1af 0x22b8 0x1f4 0x19b 0x1ae 0x2bc 0x17d 0x19a 0x352 0x173 0x17c 0x41a 0x15f 0x172 0x514 0xffffdd48 0x15e 0x5dc>;
				vivo,9v-parallel-fboff-tc-row-col = <0x6 0x3>;
				vivo,9v-parallel-fbon-tc-data = <0x191 0x22b8 0x200 0x182 0x190 0x320 0xffffdd48 0x181 0x3e8>;
				vivo,9v-parallel-fbon-tc-row-col = <0x3 0x3>;
				vivo,9v-primary-fboff-tc-data = <0x1c3 0x22b8 0x200 0x1af 0x1c2 0x200 0x19b 0x1ae 0x4b0 0x187 0x19a 0x546 0x173 0x186 0x640 0x16e 0x172 0x708 0xffffdd48 0x16d 0x7d0>;
				vivo,9v-primary-fboff-tc-row-col = <0x7 0x3>;
				vivo,9v-primary-fbon-tc-data = <0x1e1 0x22b8 0x1f4 0x1d7 0x1e0 0x258 0x1c3 0x1d6 0x384 0x1a5 0x1c2 0x44c 0x187 0x1a4 0x514 0xffffdd48 0x186 0x5dc>;
				vivo,9v-primary-fbon-tc-row-col = <0x6 0x3>;
				vivo,adapter-cooldown-data = <0x384 0x352 0xd48>;
				vivo,adapter-power-derate-enable;
				vivo,bat-det-method = <0x0>;
				vivo,bat-id-gpio = <0xffffffff 0x9f 0x0>;
				vivo,calling-dchg-disable;
				vivo,calling-scale-data = <0x64 0x15>;
				vivo,calling-scale-enable;
				vivo,charge-param-judge-threshold = <0x5 0x2 0xdac 0x10cc 0x3e8 0x834 0x1388 0x2af8>;
				vivo,charge-test-param-data = <0x0 0x0 0x157c 0x0 0x0 0x157c 0x0 0x0 0x157c 0x1 0x14 0x28 0x1 0x14 0x2d 0x0 0x14 0x32 0x0 0x14 0x2d 0x0 0x14 0x2d 0x0 0x14 0x2d 0x0 0x14 0x32 0x0 0x14 0x32 0x0 0x14 0x32>;
				vivo,charge-test-param-row-col = <0xc 0x3>;
				vivo,chg-timeout-mins = <0x384>;
				vivo,dchg-ntc-protect-data = <0x2ee 0x320 0x352 0x352>;
				vivo,dchg-ntc-protect-enable;
				vivo,direct-charger-enable;
				vivo,dp-batt-temp-data = <0x64>;
				vivo,dp-batt-temp-enable;
				vivo,ex-bms-psy-name = "bq_bms";
				vivo,exhibition-mode-current-parallel = <0x0>;
				vivo,exhibition-mode-current-primary = <0x800>;
				vivo,fbon-scale-data = <0x2 0x64 0x64>;
				vivo,fixed-scale-data = <0x78 0xed8 0x0>;
				vivo,flash-charge-param-judge-threshold = <0xb 0x3 0xdac 0x1004 0x3e8 0x898 0xfa0 0x17d4>;
				vivo,flash-charge-test-param-data = <0x1 0x0 0x157c 0x1 0x0 0x157c 0x0 0x0 0x157c 0x1 0x14 0x28 0x1 0x14 0x2d 0x0 0x14 0x32 0x1 0x14 0x2d 0x0 0x14 0x2d 0x1 0x14 0x2d 0x0 0x14 0x32 0x0 0x14 0x32 0x0 0x14 0x32>;
				vivo,flash-charge-test-param-row-col = <0xc 0x3>;
				vivo,flash-normal-tc-data = <0x226 0x22b8 0x0 0x0 0x0 0x0 0x0 0x1c2 0x225 0x32 0x0 0x0 0x0 0x0 0xc8 0x1c1 0xdf 0x42fc70 0xb3 0x432380 0x86 0x96 0xc7 0xcb 0x40d990 0x98 0x0 0x0 0x64 0x95 0x78 0x401640 0x64 0x0 0x0 0x32 0x63 0x46 0x401640 0x32 0x0 0x0 0x0 0x31 0x32 0x42d560 0x32 0x0 0x0 0xffffffce 0xffffffff 0x1e 0x0 0x0 0x0 0x0 0xffffff9c 0xffffffcd 0x14 0x0 0x0 0x0 0x0 0xffffdd48 0xffffff9b 0x0 0x0 0x0 0x0 0x0>;
				vivo,flash-normal-tc-row-col = <0xa 0x7>;
				vivo,htccc-data = <0x2e 0x37 0x3e8fa0 0x186a0>;
				vivo,htccc-enable;
				vivo,intell-charge-enable;
				vivo,normal-tc-data = <0x226 0x22b8 0x0 0x0 0x0 0x0 0x0 0x1c2 0x225 0x32 0x0 0x0 0x0 0x0 0xc8 0x1c1 0x7a 0x401640 0x64 0x0 0x0 0x96 0xc7 0x64 0x0 0x0 0x0 0x0 0x64 0x95 0x64 0x401640 0x46 0x0 0x0 0x32 0x63 0x46 0x401640 0x32 0x0 0x0 0x0 0x31 0x32 0x0 0x0 0x0 0x0 0xffffdd48 0xffffffff 0x0 0x0 0x0 0x0 0x0 0xffffdd48 0xffffffff 0x0 0x0 0x0 0x0 0x0 0xffffdd48 0xffffffff 0x0 0x0 0x0 0x0 0x0>;
				vivo,normal-tc-row-col = <0xa 0x7>;
				vivo,parallel-fboff-tc-data = <0xffffdd48 0x22b8 0x0>;
				vivo,parallel-fboff-tc-row-col = <0x1 0x3>;
				vivo,parallel-fbon-tc-data = <0xffffdd48 0x22b8 0x0>;
				vivo,parallel-fbon-tc-row-col = <0x1 0x3>;
				vivo,parallel-temp-enable = <0x1 0x1>;
				vivo,primary-fboff-tc-data = <0x1c2 0x22b8 0x708 0x186 0x1c1 0xbb8 0x17c 0x185 0xd48 0x178 0x17b 0xe74 0x173 0x177 0x1004 0xffffdd48 0x172 0x1770>;
				vivo,primary-fboff-tc-row-col = <0x6 0x3>;
				vivo,primary-fbon-tc-data = <0x1cc 0x22b8 0x640 0x19a 0x1cb 0xa28 0x190 0x199 0xbb8 0x186 0x18f 0xce4 0x173 0x185 0xe74 0xffffdd48 0x172 0x1770>;
				vivo,primary-fbon-tc-row-col = <0x6 0x3>;
				vivo,switch-scale-data = <0x4b 0x35>;
				vivo,usb-conn-heat-protect-data = <0x104 0x22b8 0x29e 0x26c 0xffffdd48 0x103 0x23a 0x208>;
				vivo,usb-conn-heat-protect-data-row-col = <0x2 0x4>;
				vivo,usb-connecter-protect-enable = <0x1>;
				vivo,usb-id-protect-data = <0x44c 0x60b 0x1f4>;
				vivo,weixin-calling-scale-data = <0x64 0x70>;
				vivo,weixin-calling-scale-enable;
			};
		};
	};

	fragment@58 {
		target = <0xffffffff>;

		__overlay__ {
			compatible = "vivo,power_supply_lite";
			status = "okay";
		};
	};

	fragment@59 {
		target = <0xffffffff>;

		__overlay__ {
			chg-scheme = <0x2>;
			compatible = "vivo,fuelsummary";
			fboff-ibat = <0xfffffc18>;
			fbon-ibat = <0xfffffc7c>;
			fex-version = <0x3>;
			status = "okay";
			vivo,battery-aging-support = <0x2>;
		};
	};

	fragment@6 {
		target = <0xffffffff>;

		__overlay__ {

			consys_default {
				phandle = <0x1>;
			};

			gpslna@0 {
				phandle = <0x2>;

				pins_cmd_dat {
					bias-disable;
					output-low;
					pinmux = <0x5b00>;
					slew-rate = <0x0>;
				};
			};

			gpslna@1 {
				phandle = <0x3>;

				pins_cmd_dat {
					output-high;
					pinmux = <0x5b00>;
					slew-rate = <0x1>;
				};
			};

			gpslna@2 {
				phandle = <0x4>;

				pins_cmd_dat {
					output-low;
					pinmux = <0x5b00>;
					slew-rate = <0x1>;
				};
			};
		};
	};

	fragment@60 {
		target = <0xffffffff>;

		__overlay__ {
			#address-cells = <0x1>;
			#size-cells = <0x0>;
			clock-frequency = <0x186a0>;
			status = "okay";

			bq25601d@6b {
				compatible = "ti,bq25601d";
				reg = <0x6b>;
				vivo,int-gpio = <0xffffffff 0xb 0x0>;
			};

			bq25890h@6a {
				compatible = "ti,bq25890h";
				reg = <0x6a>;
				vivo,int-gpio = <0xffffffff 0xb 0x0>;
			};

			rt9467@5b {
				compatible = "richtek,rt9467";
				reg = <0x5b>;
				vivo,int-gpio = <0xffffffff 0xb 0x0>;
			};
		};
	};

	fragment@61 {
		target = <0xffffffff>;

		__overlay__ {
			fpc,enable-wakeup;
			interrupt-parent = <0xffffffff>;
			interrupts = <0x5 0x1 0x5 0x0>;
			status = "okay";
			vfp-supply = <0xffffffff>;
		};
	};

	fragment@62 {
		target = <0xffffffff>;

		__overlay__ {
			int-gpios = <0xffffffff 0x5 0x0>;
		};
	};

	fragment@63 {
		target = <0xffffffff>;

		__overlay__ {
			interrupt-parent = <0xffffffff>;
			interrupts = <0x2c 0x1 0x2c 0x1>;
			status = "okay";
		};
	};

	fragment@64 {
		target = <0xffffffff>;

		__overlay__ {
			interrupt-parent = <0xffffffff>;
			interrupts = <0x90 0x4 0x90 0x1>;
			status = "okay";
		};
	};

	fragment@65 {
		target = <0xffffffff>;

		__overlay__ {
			compatible = "mediatek,md1_sim1_hot_plug_eint-eint";
			debounce = <0x0 0x186a0>;
			dedicated = <0x0 0x0>;
			interrupts = <0x0 0x8>;
			sockettype = <0x0 0x0>;
			src_pin = <0x0 0x1>;
			status = "okay";
		};
	};

	fragment@66 {
		target = <0xffffffff>;

		__overlay__ {
			regulator-default-on = <0x1>;
			regulator-name = "vcama";
			status = "okay";
		};
	};

	fragment@67 {
		target = <0xffffffff>;

		__overlay__ {
			regulator-default-on = <0x1>;
			regulator-name = "vsim1";
			status = "okay";
		};
	};

	fragment@68 {
		target = <0xffffffff>;

		__overlay__ {
			regulator-default-on = <0x1>;
			regulator-name = "vsim2";
			status = "okay";
		};
	};

	fragment@69 {
		target = <0xffffffff>;

		__overlay__ {
			regulator-default-on = <0x1>;
			regulator-name = "vcamd";
			status = "okay";
		};
	};

	fragment@7 {
		target = <0xffffffff>;

		__overlay__ {
			pinctrl-0 = <0x1>;
			pinctrl-1 = <0x2>;
			pinctrl-2 = <0x3>;
			pinctrl-3 = <0x4>;
			pinctrl-names = "default", "gps_lna_state_init", "gps_lna_state_oh", "gps_lna_state_ol";
			status = "okay";
		};
	};

	fragment@70 {
		target = <0xffffffff>;

		__overlay__ {
			regulator-default-on = <0x1>;
			regulator-name = "vcamio";
			status = "okay";
		};
	};

	fragment@71 {
		target = <0xffffffff>;

		__overlay__ {
			regulator-default-on = <0x2>;
			regulator-max-microvolt = <0x2dc6c0>;
			regulator-min-microvolt = <0x2dc6c0>;
			regulator-name = "vldo28";
			status = "okay";
		};
	};

	fragment@72 {
		target = <0xffffffff>;

		__overlay__ {
			regulator-default-on = <0x1>;
			regulator-name = "vldo28";
			status = "okay";
		};
	};

	fragment@73 {
		target = <0xffffffff>;

		__overlay__ {
			cam0_enable_sensor = "ov13b10pd2036_mipi_raw imx258pd2036_mipi_raw";
			cam0_vcamd-supply = <0xffffffff>;
			cam0_vcamio-supply = <0xffffffff>;
			cam1_enable_sensor = "s5k4h7yxpd2036_mipi_raw s5k4h7yxv1pd2036_mipi_raw hi846pd2036_mipi_raw hi846v1pd2036_mipi_raw";
			cam1_vcamd-supply = <0xffffffff>;
			cam1_vcamio-supply = <0xffffffff>;
			cam2_enable_sensor = "gc02m1bpd2036_mipi_mono gc02m1bv1pd2036_mipi_mono";
			cam2_vcamio-supply = <0xffffffff>;
			cam3_enable_sensor = "ov02b10_mipi_raw";
			cam3_vcamd-supply = <0xffffffff>;
			cam3_vcamio-supply = <0xffffffff>;
			status = "okay";
		};
	};

	fragment@74 {
		target = <0xffffffff>;

		__overlay__ {
			camaf_m1_pmic-supply = <0xffffffff>;
		};
	};

	fragment@75 {
		target = <0xffffffff>;

		__overlay__ {
			mediatek,kpd-hw-dl-key0 = <0x11>;
			mediatek,kpd-hw-dl-key1 = <0x0>;
			mediatek,kpd-hw-dl-key2 = <0x8>;
			mediatek,kpd-hw-factory-key = <0x0>;
			mediatek,kpd-hw-init-map = <0x73 0x72 0x0 0x0 0x0 0x0 0x0 0x0 0x0 0x0 0x0 0x0 0x0 0x0 0x0 0x0 0x0 0x0 0x0 0x0 0x0 0x0 0x0 0x0 0x0 0x0 0x0 0x0 0x0 0x0 0x0 0x0 0x0 0x0 0x0 0x0 0x0 0x0 0x0 0x0 0x0 0x0 0x0 0x0 0x0 0x0 0x0 0x0 0x0 0x0 0x0 0x0 0x0 0x0 0x0 0x0 0x0 0x0 0x0 0x0 0x0 0x0 0x0 0x0 0x0 0x0 0x0 0x0 0x0 0x0 0x0 0x0>;
			mediatek,kpd-hw-map-num = <0x48>;
			mediatek,kpd-hw-pwrkey = <0x8>;
			mediatek,kpd-hw-recovery-key = <0x11>;
			mediatek,kpd-hw-rstkey = <0x11>;
			mediatek,kpd-key-debounce = <0x400>;
			mediatek,kpd-pwkey-gpio-din = <0x0>;
			mediatek,kpd-pwrkey-eint-gpio = <0x0>;
			mediatek,kpd-sw-pwrkey = <0x74>;
			mediatek,kpd-sw-rstkey = <0x72>;
			mediatek,kpd-use-extend-type = <0x0>;
			status = "okay";
		};
	};

	fragment@76 {
		target = <0xffffffff>;

		__overlay__ {
			compatible-gpios = <0xffffffff 0xaf 0x0>;
		};
	};

	fragment@77 {
		target = <0xffffffff>;

		__overlay__ {
			gpio_nums = <0x6>;
			gpios = <0xad 0xae 0xaf 0xb0 0xb1 0xb2>;
			gpios_start = <0xffffffff 0xad 0x0>;
			pcb_gpio_nums = <0x2>;
			pcb_gpios = <0x36 0x4e>;
			pcb_gpios_start = <0xffffffff 0x36 0x0>;
			pinctrl-0 = <0x56>;
			pinctrl-names = "default";
		};
	};

	fragment@78 {
		target = <0xffffffff>;

		__overlay__ {
			vivo,vendor_project_cpu = "MT6765";
			vivo,vendor_project_cpunum = <0x8>;
			vivo,vendor_project_freq = "2.3";
			vivo,vendor_project_name = "PD2036F_EX";
		};
	};

	fragment@79 {
		target = <0xffffffff>;

		__overlay__ {
			card-detect-sim1,gpios = <0xffffffff 0x2f 0x0>;
			card-detect-sim2,gpios = <0xffffffff 0x2f 0x0>;
			card-detect-tf-card,gpios = <0xffffffff 0x1 0x0>;
			factory-test,sim1-card;
			factory-test,sim2-card;
			factory-test,tf-card;
			pinctrl-0 = <0x57>;
			pinctrl-names = "default";
			vivo,new_card_detect;
		};
	};

	fragment@8 {
		target = <0xffffffff>;

		__overlay__ {
			pinctrl-0 = <0x5>;
			pinctrl-names = "default";
		};
	};

	fragment@80 {
		target = <0xffffffff>;

		__overlay__ {

			card_sim_detect {
				phandle = <0x57>;

				pins_cmd0_dat {
					bias-disable;
					pinmux = <0x2f01>;
					slew-rate = <0x0>;
				};

				pins_cmd1_dat {
					bias-disable;
					pinmux = <0x2e00>;
					slew-rate = <0x0>;
				};

				pins_cmd2_dat {
					bias-disable;
					pinmux = <0x100>;
					slew-rate = <0x0>;
				};
			};

			hardware_board_version {
				phandle = <0x56>;

				pins_cmd0_dat {
					bias-pull-up = <0x1>;
					pinmux = <0xad00>;
					slew-rate = <0x0>;
				};

				pins_cmd1_dat {
					bias-pull-up = <0x1>;
					pinmux = <0xae00>;
					slew-rate = <0x0>;
				};

				pins_cmd2_dat {
					bias-pull-up = <0x1>;
					pinmux = <0xaf00>;
					slew-rate = <0x0>;
				};

				pins_cmd3_dat {
					bias-pull-up = <0x1>;
					pinmux = <0xb000>;
					slew-rate = <0x0>;
				};

				pins_cmd4_dat {
					bias-pull-up = <0x1>;
					pinmux = <0xb100>;
					slew-rate = <0x0>;
				};

				pins_cmd5_dat {
					bias-pull-up = <0x1>;
					pinmux = <0xb200>;
					slew-rate = <0x0>;
				};
			};
		};
	};

	fragment@81 {
		target = <0xffffffff>;

		__overlay__ {

			vivo-audio-ktv@0 {
				compatible = "vivo,vivo-audio-ktv";
				status = "okay";
			};

			vivo-soc-codec@0 {
				compatible = "vivo,vivo-soc-codec";
				status = "okay";
			};
		};
	};

	fragment@82 {
		target = <0xffffffff>;

		__overlay__ {

			aw87xxx_i2c@58 {
				compatible = "awinic,aw87xxx_pa";
				reg = <0x58>;
				reset-gpio = <0xffffffff 0x9a 0x0>;
				status = "okay";
			};
		};
	};

	fragment@83 {
		target = <0xffffffff>;

		__overlay__ {
			compatible = "vivo,touchscreen-config";
			status = "okay";
			vivo,ts-anti-esd = <0x1>;
			vivo,ts-charger-conn-judge = <0x1>;
			vivo,ts-custom-gesture = <0x0>;
			vivo,ts-dclick-wake = <0x1>;
			vivo,ts-fw-upgrade-lcd-referrence = <0x0>;
			vivo,ts-gesture-mode = <0x1>;
			vivo,ts-gloves-mode = <0x0>;
			vivo,ts-large-obj-suppression = <0x1>;
			vivo,ts-module-id-methods = <0x2>;
			vivo,ts-module-smt-mode = <0x1>;
			vivo,ts-product-name = "PD2014";
			vivo,ts_vdd_mode = "gpio_mode";
			vivo,use-ic-list = "nt36525";

			tp_modue10 {
				compatible = "vivo,touch-panel-module";
				vts-dimention-x = <0x2d0>;
				vts-dimention-y = <0x640>;
				vts-gesture = <0x0>;
				vts-ic-number = <0x5b>;
				vts-incell = <0x1>;
				vts-lcmid = <0x68>;
				vts-long-press = <0x0>;
				vts-module-vendor = <0xf0>;
				vts-need-caliberation = <0x0>;
				vts-no-flash = <0x1>;
				vts-rx-sensors = <0x20>;
				vts-tx-sensors = <0x12>;
				vts-type = <0x0>;
				vts-virtual-proximinity = <0x0>;
			};

			tp_modue2 {
				compatible = "vivo,touch-panel-module";
				vts-dimention-x = <0x2d0>;
				vts-dimention-y = <0x640>;
				vts-gesture = <0x1>;
				vts-ic-number = <0x52>;
				vts-incell = <0x1>;
				vts-lcmid = <0xa1>;
				vts-long-press = <0x0>;
				vts-module-vendor = <0xf0>;
				vts-need-caliberation = <0x0>;
				vts-no-flash = <0x1>;
				vts-rx-sensors = <0x20>;
				vts-tx-sensors = <0x12>;
				vts-type = <0x0>;
				vts-virtual-proximinity = <0x0>;
			};

			tp_modue3 {
				compatible = "vivo,touch-panel-module";
				vts-dimention-x = <0x2d0>;
				vts-dimention-y = <0x640>;
				vts-gesture = <0x1>;
				vts-ic-number = <0x52>;
				vts-incell = <0x1>;
				vts-lcmid = <0xb1>;
				vts-long-press = <0x0>;
				vts-module-vendor = <0xf0>;
				vts-need-caliberation = <0x0>;
				vts-no-flash = <0x1>;
				vts-rx-sensors = <0x20>;
				vts-tx-sensors = <0x12>;
				vts-type = <0x0>;
				vts-virtual-proximinity = <0x0>;
			};

			tp_modue5 {
				compatible = "vivo,touch-panel-module";
				vts-dimention-x = <0x2d0>;
				vts-dimention-y = <0x640>;
				vts-gesture = <0x1>;
				vts-ic-number = <0x52>;
				vts-incell = <0x1>;
				vts-lcmid = <0xb2>;
				vts-long-press = <0x0>;
				vts-module-vendor = <0xf0>;
				vts-need-caliberation = <0x0>;
				vts-no-flash = <0x1>;
				vts-rx-sensors = <0x20>;
				vts-tx-sensors = <0x12>;
				vts-type = <0x0>;
				vts-virtual-proximinity = <0x0>;
			};

			tp_modue7 {
				compatible = "vivo,touch-panel-module";
				vts-dimention-x = <0x2d0>;
				vts-dimention-y = <0x640>;
				vts-ic-number = <0x54>;
				vts-incell = <0x1>;
				vts-lcmid = <0x91>;
				vts-long-press = <0x0>;
				vts-module-vendor = <0xf0>;
				vts-need-caliberation = <0x0>;
				vts-no-flash = <0x1>;
				vts-rx-sensors = <0x20>;
				vts-tx-sensors = <0x12>;
				vts-type = <0x0>;
				vts-virtual-proximinity = <0x0>;
			};

			tp_modue8 {
				compatible = "vivo,touch-panel-module";
				vts-dimention-x = <0x2d0>;
				vts-dimention-y = <0x640>;
				vts-ic-number = <0x25>;
				vts-incell = <0x1>;
				vts-lcmid = <0x92>;
				vts-long-press = <0x0>;
				vts-module-vendor = <0xf0>;
				vts-need-caliberation = <0x0>;
				vts-no-flash = <0x1>;
				vts-rx-sensors = <0x20>;
				vts-tx-sensors = <0x12>;
				vts-type = <0x0>;
				vts-virtual-proximinity = <0x0>;
			};

			tp_moduel {
				compatible = "vivo,touch-panel-module";
				vts-dimention-x = <0x2d0>;
				vts-dimention-y = <0x640>;
				vts-gesture = <0x1>;
				vts-ic-number = <0x52>;
				vts-incell = <0x1>;
				vts-lcmid = <0x31>;
				vts-long-press = <0x0>;
				vts-module-vendor = <0xf0>;
				vts-need-caliberation = <0x0>;
				vts-no-flash = <0x1>;
				vts-rx-sensors = <0x20>;
				vts-tx-sensors = <0x12>;
				vts-type = <0x0>;
				vts-virtual-proximinity = <0x0>;
			};

			tp_module4 {
				compatible = "vivo,touch-panel-module";
				vts-dimention-x = <0x2d0>;
				vts-dimention-y = <0x640>;
				vts-ic-number = <0x5a>;
				vts-incell = <0x1>;
				vts-lcmid = <0x11>;
				vts-long-press = <0x0>;
				vts-module-vendor = <0xf0>;
				vts-need-caliberation = <0x0>;
				vts-no-flash = <0x1>;
				vts-rx-sensors = <0x20>;
				vts-tx-sensors = <0x12>;
				vts-type = <0x0>;
				vts-virtual-proximinity = <0x0>;
			};

			tp_module6 {
				compatible = "vivo,touch-panel-module";
				vts-dimention-x = <0x2d0>;
				vts-dimention-y = <0x640>;
				vts-gesture = <0x0>;
				vts-ic-number = <0x5b>;
				vts-incell = <0x1>;
				vts-lcmid = <0xb3>;
				vts-long-press = <0x0>;
				vts-module-vendor = <0xf0>;
				vts-need-caliberation = <0x0>;
				vts-no-flash = <0x1>;
				vts-rx-sensors = <0x20>;
				vts-tx-sensors = <0x12>;
				vts-type = <0x0>;
				vts-virtual-proximinity = <0x0>;
			};

			tp_module9 {
				compatible = "vivo,touch-panel-module";
				vts-dimention-x = <0x2d0>;
				vts-dimention-y = <0x640>;
				vts-game-idle-time = <0xa>;
				vts-game-mode = <0x1>;
				vts-gesture = <0x1>;
				vts-ic-number = <0x6e>;
				vts-incell = <0x1>;
				vts-lcmid = <0x93>;
				vts-long-press = <0x0>;
				vts-module-vendor = <0xf0>;
				vts-need-caliberation = <0x0>;
				vts-no-flash = <0x1>;
				vts-rx-sensors = <0x20>;
				vts-tx-sensors = <0x12>;
				vts-type = <0x0>;
				vts-virtual-proximinity = <0x0>;
			};
		};
	};

	fragment@84 {
		target = <0xffffffff>;

		__overlay__ {

			spi2_clk_set {
				phandle = <0x58>;

				pins_cmd_dat {
					bias-disable;
					drive-strength = <0x3>;
					pinmux = <0x1202>;
				};
			};

			spi2_cs_set {
				phandle = <0x76>;

				pins_cmd_dat {
					bias-disable;
					drive-strength = <0x3>;
					pinmux = <0x1400>;
				};
			};

			spi2_miso_set {
				phandle = <0x77>;

				pins_cmd_dat {
					bias-disable;
					drive-strength = <0x3>;
					pinmux = <0x1300>;
				};
			};

			spi2_mosi_set {
				phandle = <0x78>;

				pins_cmd_dat {
					bias-disable;
					drive-strength = <0x3>;
					pinmux = <0x1102>;
				};
			};

			spi_pins_pd2036 {
				phandle = <0x79>;

				pins_cmd_dat {
					bias-disable;
					drive-strength = <0x3>;
					pinmux = <0x1202 0x1302 0x1102 0x1402>;
				};
			};
		};
	};

	fragment@85 {
		target = <0xffffffff>;

		__overlay__ {
			#address-cells = <0x1>;
			#size-cells = <0x0>;

			vts_device@0 {
				compatible = "vivo,ts-spi";
				reg = <0x0>;
				spi-max-frequency = <0x493e00>;
				status = "okay";

				chipone {
					chipone,irq-gpio = <0xffffffff 0x0 0x2>;
					chipone,rst-gpio = <0xffffffff 0x15 0x0>;
					chipone,x-res = <0x2d0>;
					chipone,y-res = <0x640>;
					compatible = "chipone,cts_nl9911c_spi";
					lcm-noise-test-key = "com.touchscreen.chipone.vivo_noise:NoiseActivity:null:null:null";
					rawdata-test-key = "com.touchscreen.chipone.icnl9911c:DataShowActivity:null:null:null";
					rf-noise-test-key = "com.touchscreen.chipone.vivo_noise:BspTestActivity:action_noise_test:0:result";
					sensor-test-key = "com.touchscreen.chipone:MainActivity:android.intent.action.chipone:0:testResult";
					spi-max-frequency = <0x927c00>;
					status = "ok";
					vts-ic-number = <0x6e>;
					vts-type = <0x0>;
				};

				ft8016 {
					compatible = "focaltech,ft8756_v2";
					focaltech,display-coords = <0x0 0x0 0x2d0 0x640>;
					focaltech,ic_name = "ft8016";
					focaltech,irq-gpio = <0xffffffff 0x0 0x2>;
					focaltech,max-touch-number = <0xa>;
					focaltech,reset-gpio = <0xffffffff 0x15 0x0>;
					lcm-noise-test-key = "com.focaltech.deltadiff:MainActivity:null:null:null";
					rawdata-test-key = "com.focaltech.deltadiff:DataActivity:null:null:null";
					rf-noise-test-key = "com.focaltech.deltadiff:BspTestActivity:com.focaltech.deltadiff:0:testResult";
					sensor-test-key = "com.focaltouchscreen.sensortest:MainActivity:com.focaltouchscreen.sensortest:0:focal_test_result";
					spi-max-frequency = <0x5b8d80>;
					vts-ic-number = <0x25>;
					vts-type = <0x0>;
				};

				ili9881h {
					compatible = "ilitek,ILI-ts-spi-v2";
					ilitek,irq-gpio = <0xffffffff 0x0 0x2>;
					ilitek,reset-gpio = <0xffffffff 0x15 0x0>;
					lcm-noise-test-key = "com.ilitek.touchscreen.noise:MainActivity:null:null:null";
					rawdata-test-key = "com.ilitek.touchscreen.noise:DataShowActivity:null:null:null";
					rf-noise-test-key = "com.ilitek.touchscreen.noise:BspTestActivity:com.ilitek.touchscreen.action.noisetest:0:ILITEK_TpTestResult";
					sensor-test-key = "com.ilitek.touchscreen.tptest:MainActivity:com.ilitek.touchscreen.action.tptest:0:ILITEK_TpTestResult";
					spi-max-frequency = <0x927c00>;
					status = "ok";
					vts-ic-number = <0x5a>;
					vts-type = <0x0>;
				};

				ili_9882n {
					compatible = "tchip,ilitek";
					lcm-noise-test-key = "com.ilitek.touchscreen.noisev2:MainActivity:null:null:null";
					rawdata-test-key = "com.ilitek.touchscreen.noisev2:DataShowActivity:null:null:null";
					rf-noise-test-key = "com.ilitek.touchscreen.noisev2:BspTestActivity:com.ilitek.touchscreen.action.noisetest:0:ILITEK_TpTestResult";
					sensor-test-key = "com.ilitek.touchscreen.tptest3X:MP3XActivity:com.ilitek.touchscreen.action.tptest:0:ILITEK_TpTestResult";
					spi-max-frequency = <0x927c00>;
					status = "okay";
					touch,irq-gpio = <0xffffffff 0x0 0x2>;
					touch,reset-gpio = <0xffffffff 0x15 0x0>;
					vts-ic-number = <0x5b>;
					vts-type = <0x0>;
				};

				nt36525 {
					compatible = "novatek,NVT-ts-spi-v2";
					lcm-noise-test-key = "com.nt36xxxtouchscreen.deltadiff:MainActivity:null:null:null";
					novatek,irq-gpio = <0xffffffff 0x0 0x2>;
					novatek,reset-gpio = <0xffffffff 0x15 0x0>;
					novatek,swrst-n8-addr = <0x3f0fe>;
					pinctrl-0 = <0x58>;
					pinctrl-names = "spi_clk_active", "spi_mosi_active";
					rawdata-test-key = "com.nttouchscreen.getdata:MainActivity:null:null:null";
					rf-noise-test-key = "com.nt36xxxtouchscreen.deltadiff:BspTest:android.intent.action.nvtdeltadiff:0:testResult";
					sensor-test-key = "com.nttouchscreen.mptest:MainActivity:android.intent.action.novatek:0:testResult";
					spi-max-frequency = <0x927c00>;
					status = "ok";
					vts-ic-number = <0x54>;
					vts-type = <0x0>;
				};

				nt36672 {
					compatible = "novatek,NVT-ts-spi-v2";
					lcm-noise-test-key = "com.nt36xxxtouchscreen.deltadiff:MainActivity:null:null:null";
					novatek,irq-gpio = <0xffffffff 0x0 0x2>;
					novatek,swrst-n8-addr = <0x3f0fe>;
					pinctrl-0 = <0x58>;
					pinctrl-names = "spi_clk_active", "spi_mosi_active";
					rawdata-test-key = "com.nttouchscreen.getdata:MainActivity:null:null:null";
					rf-noise-test-key = "com.nt36xxxtouchscreen.deltadiff:BspTest:android.intent.action.nvtdeltadiff:0:testResult";
					sensor-test-key = "com.nttouchscreen.mptest:MainActivity:android.intent.action.novatek:0:testResult";
					spi-max-frequency = <0x927c00>;
					status = "ok";
					vts-ic-number = <0x52>;
					vts-type = <0x0>;
				};
			};
		};
	};

	fragment@9 {
		target = <0xffffffff>;

		__overlay__ {

			kpdgpiodefault {
				phandle = <0x5>;

				pins_cmd_dat {
					bias-pull-up = <0x66>;
					input-schmitt-enable;
					output-low;
					pinmux = <0x5d01>;
				};
			};
		};
	};
};
